## drivers/base/Kconfig
```kconfig
menu "Generic Driver Options"

config UEVENT_HELPER_PATH
	string "path to uevent helper"
	depends on HOTPLUG
	default "/sbin/hotplug"
	help
	  Path to uevent helper program forked by the kernel for
	  every uevent.

config DEVTMPFS
	bool "Create a kernel maintained /dev tmpfs (EXPERIMENTAL)"
	depends on HOTPLUG && SHMEM && TMPFS
	help
	  This creates a tmpfs filesystem, and mounts it at bootup
	  and mounts it at /dev. The kernel driver core creates device
	  nodes for all registered devices in that filesystem. All device
	  nodes are owned by root and have the default mode of 0600.
	  Userspace can add and delete the nodes as needed. This is
	  intended to simplify bootup, and make it possible to delay
	  the initial coldplug at bootup done by udev in userspace.
	  It should also provide a simpler way for rescue systems
	  to bring up a kernel with dynamic major/minor numbers.
	  Meaningful symlinks, permissions and device ownership must
	  still be handled by userspace.
	  If unsure, say N here.

config DEVTMPFS_MOUNT
	bool "Automount devtmpfs at /dev"
	depends on DEVTMPFS
	help
	  This will mount devtmpfs at /dev if the kernel mounts the root
	  filesystem. It will not affect initramfs based mounting.
	  If unsure, say N here.

config STANDALONE
	bool "Select only drivers that don't need compile-time external firmware" if EXPERIMENTAL
	default y
	help
	  Select this option if you don't have magic firmware for drivers that
	  need it.

	  If unsure, say Y.

config PREVENT_FIRMWARE_BUILD
	bool "Prevent firmware from being built"
	default y
	help
	  Say yes to avoid building firmware. Firmware is usually shipped
	  with the driver, and only when updating the firmware a rebuild
	  should be made.
	  If unsure say Y here.

config FW_LOADER
	tristate "Userspace firmware loading support"
	depends on HOTPLUG
	---help---
	  This option is provided for the case where no in-kernel-tree modules
	  require userspace firmware loading support, but a module built outside
	  the kernel tree does.

config DEBUG_DRIVER
	bool "Driver Core verbose debug messages"
	depends on DEBUG_KERNEL
	help
	  Say Y here if you want the Driver core to produce a bunch of
	  debug messages to the system log. Select this if you are having a
	  problem with the driver core and want to see more of what is
	  going on.

	  If you are unsure about this, say N here.

config DEBUG_DEVRES
	bool "Managed device resources verbose debug messages"
	depends on DEBUG_KERNEL
	help
	  This option enables kernel parameter devres.log. If set to
	  non-zero, devres debug messages are printed. Select this if
	  you are having a problem with devres or want to debug
	  resource management for a managed device. devres.log can be
	  switched on and off from sysfs node.

	  If you are unsure about this, Say N here.

config SYS_HYPERVISOR
	bool
	default n

endmenu
```

## drivers/misc/mediatek/dual_camera/Kconfig
```kconfig
config MTK_SUPPORT_CAMLP
	bool "Support cam light sensor board"
	default n
	---help---
	  LED driver for cam light sensor support.
	  Set y to support.
	  Set n to disable.
```

## drivers/misc/mediatek/eem_v2/Kconfig
```kconfig
config MTK_PTPOD_LEGACY
	tristate "MediaTek Performance Thermal Power OverDrive for legacy chip"
	help
	  This driver calculate the minimum voltage of specified frequency
	  by efuse data and get the temperature from thermal to make up the voltage.
	  Select "y" if you want to enable this features.
	  Select "n" if unsure.
config MTK_PTPOD_ENG_DEBUG
	bool "Enable certain PTPOD debug nodes for eng build"
	depends on MTK_PTPOD_LEGACY
	help
		Enable certain PTPOD debug nodes in engineering builds.
		Select "y" if you want to enable these features.
		Select "n" if unsure.
```

## drivers/misc/mediatek/sensors-1.0/accelerometer/icm42607_a/Kconfig
```kconfig
config MTK_ICM42607_A
        bool "ICM42607 for MediaTek package"
        default n
        help
        It support different accelerometer sensor.
        If this option is set,
            it will support
            ICM42607 accelerometer.
```

## drivers/misc/mediatek/sensors-1.0/accelerometer/sc7a20-new/Kconfig
```kconfig
config MTK_SC7A20_NEW
	bool "SC7A20 for MediaTek package"
	default n
	help
	  The SC7A20 is a highly integrated,
	  low power internal measurement unit
	  that provides precise acceleration
	  measurement.
	  this config will turn on accelerometer feature.
```

## drivers/misc/mediatek/sensors-1.0/alsps/sc7lc30_new/Kconfig
```kconfig
config MTK_SC7LC30_NEW
	bool "MTK_SC7LC30_NEW for MediaTek package"
	default n
	help
	It support different type sensor
	in this platform. If this option
	is set, it will support ambient
	and light sensor MTK_SC7LC30_NEW.
```

## drivers/misc/mediatek/sensors-1.0/gyroscope/icm42607_g/Kconfig
```kconfig
config MTK_ICM42607_G
        bool "ICM42607 for MediaTek package"
        default n
        help
        It support different gyroscope sensor.
        If this option is set,
            it will support
            ICM42607 gyroscope.
```

## drivers/misc/mediatek/sensors-1.0/magnetometer/afx133/Kconfig
```kconfig
config MTK_AFX133
	bool "AFX133 for MediaTek package"
	default n
	help
	  It support different magnetometer sensor.
          If this option is set,
	  it will support
          AFX133 magnetometer.
```

## drivers/net/wireless/sd8xxx/Kconfig
```kconfig
config SD8XXX
	tristate "Marvell sd8xxx driver"
	depends on MAC80211 && WLAN_80211
	--help--
    Say Y if you want to have the sd8xxx wlan driver from Marvell
```

## init/Kconfig.palm
```kconfig
menu "Palm general setup"

config PANIC_ON_OOPS
	int "Panic when encountering OOPS"
	default 0
	help
	  If 1, sets behavior on OOPS to panic.

config WARN_ABOUT_MAX_FILES
	bool "Warn when file-max limit is close"
	default n
	help
	  If enabled, a log will start showing warnings

endmenu		# General setup
```

## sound/htcleo/Kconfig
```kconfig
# HTC LEO nonsoc ALSA driver

menu "HTC-LEO NonSoC Audio support"

config SND_HTCLEO
    tristate "NonSoC Audio for the HTC LEO platform"
    depends on ( MACH_HTCLEO || MACH_MAHIMAHI )
    select SND_PCM
    help
      To add support ALSA for HTC LEO platform.

endmenu
```
