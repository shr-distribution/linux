## drivers/media/platform/msm/Kconfig
```kconfig
# SPDX-License-Identifier: GPL-2.0-only

menuconfig SPECTRA_CAMERA
    bool "Qualcomm Technologies, Inc. Spectra camera and video capture support"
    depends on ARCH_QCOM && VIDEO_V4L2 && I2C
    help
      Say Y here to enable selecting the video adapters for
      Qualcomm Technologies, Inc. Spectra camera and video capture.
      Enabling this adds support for the camera driver stack including sensor,
      IFE and postprocessing drivers.

source "drivers/media/platform/msm/vidc_3x/Kconfig"

menuconfig MSM_CAMERA
     bool "QTI MSM camera and video capture support"
     depends on ARCH_QCOM && VIDEO_V4L2 && I2C
     help
       Say Y here to enable selecting the video adapters for
       QTI msm camera and video capture drivers. enabling this
       adds support for the camera driver stack including sensor, isp
       and postprocessing drivers for legacy chipsets.

config MSM_CAMERA_DEBUG
     bool "QTI MSM camera debugging with printk"
     depends on MSM_CAMERA
     default n
     help
       Say Y here to enable selecting the video adapters for
       QTI msm camera and video capture drivers. enabling this
       adds support for the camera driver stack including sensor, isp
       and postprocessing drivers for legacy chipsets.
       Enable printk() debug for msm camera.

menuconfig MSMB_CAMERA
     bool "QTI MSM camera and video capture 2.0 support"
     depends on ARCH_QCOM && VIDEO_V4L2 && I2C
     help
       Say Y here to enable selecting the video adapters for
       QTI msm camera and video capture 2.0, enabling this
       adds support for the camera driver stack including sensor, isp
       and postprocessing drivers.

menuconfig MSMB_CAMERA_LEGACY
     bool "QTI MSM camera and video capture 2.0 legacy support"
     depends on ARCH_QCOM && VIDEO_V4L2 && I2C
     select MSMB_CAMERA
     help
       Say Y here to build the kernel-4.4 era msm camera_v2 driver
       (camera_v2-legacy/) instead of the modern camera_v2/ tree.
       This is required when running with kernel-4.4 vintage mm-camera
       vendor blobs (BB OREO, Xiaomi Oreo, Sony nile Oreo, etc.) on a
       4.19 kernel base. The legacy tree preserves the OREO ABI that
       those userspace blobs were compiled against.
       Legacy msm-4.4 version

config MSMB_CAMERA_DEBUG
     bool "QTI MSM camera 2.0 debugging with printk"
     depends on MSMB_CAMERA
     help
       Say Y here to enable selecting the video adapters for
       QTI msm camera and video capture 2.0, enabling this
       adds support for the camera driver stack including sensor, isp
       and postprocessing drivers.
       Enable printk() debug for msm camera 2.0.

if MSMB_CAMERA
       source "drivers/media/platform/msm/camera_v2/Kconfig"
endif # MSMB_CAMERA

source "drivers/media/platform/msm/cvp/Kconfig"
source "drivers/media/platform/msm/npu/Kconfig"
source "drivers/media/platform/msm/synx/Kconfig"
source "drivers/media/platform/msm/dvb/Kconfig"
source "drivers/media/platform/msm/broadcast/Kconfig"
source "drivers/media/platform/msm/sde/Kconfig"
```

## drivers/media/platform/qcom/gemini/Kconfig
```kconfig
# SPDX-License-Identifier: GPL-2.0-only

config VIDEO_QCOM_GEMINI
	tristate "Qualcomm MSM8660 Gemini JPEG Encoder"
	depends on V4L_MEM2MEM_DRIVERS
	depends on VIDEO_DEV
	depends on ARCH_QCOM || COMPILE_TEST
	depends on PM
	select VIDEOBUF2_DMA_CONTIG
	select V4L2_MEM2MEM_DEV
	help
	  Enable support for the Qualcomm MSM8660/APQ8060 Gemini
	  hardware JPEG encoder.

	  This driver provides V4L2 mem2mem interface for hardware
	  accelerated JPEG encoding on MSM8660-based devices.

	  To compile this driver as a module, choose M here. The module
	  will be called qcom-gemini.
```

## drivers/media/platform/qcom/rotator/Kconfig
```kconfig
# SPDX-License-Identifier: GPL-2.0-only

config VIDEO_QCOM_ROTATOR
	tristate "Qualcomm MSM8660 Rotator"
	depends on V4L_MEM2MEM_DRIVERS
	depends on VIDEO_DEV
	depends on ARCH_QCOM || COMPILE_TEST
	depends on PM
	select VIDEOBUF2_DMA_CONTIG
	select V4L2_MEM2MEM_DEV
	help
	  Enable support for the Qualcomm MSM8660/APQ8060 hardware
	  image rotator.

	  This driver provides V4L2 mem2mem interface for hardware
	  accelerated image rotation (0/90/180/270 degrees) and
	  horizontal/vertical flipping.

	  To compile this driver as a module, choose M here. The module
	  will be called qcom-rotator.
```

## drivers/media/platform/qcom/vidc/Kconfig
```kconfig
# SPDX-License-Identifier: GPL-2.0-only

config VIDEO_QCOM_VIDC
	tristate "Qualcomm VIDC 1080p Video Codec driver"
	depends on V4L_MEM2MEM_DRIVERS
	depends on VIDEO_DEV
	depends on ARCH_QCOM || COMPILE_TEST
	depends on COMMON_CLK
	select VIDEOBUF2_DMA_CONTIG
	select V4L2_MEM2MEM_DEV
	help
	  This is a V4L2 driver for the Qualcomm VIDC 1080p video
	  encoder/decoder found in MSM8660 and APQ8060 SoCs.

	  This hardware is a predecessor to the Venus video codec
	  found in later Qualcomm SoCs and uses a different
	  register-based command interface.

	  To compile this driver as a module choose M here.
```

## drivers/media/platform/qcom/vpe/Kconfig
```kconfig
# SPDX-License-Identifier: GPL-2.0-only

config VIDEO_QCOM_VPE
	tristate "Qualcomm MSM8x60 Video Processing Engine driver"
	depends on V4L_MEM2MEM_DRIVERS
	depends on VIDEO_DEV
	depends on ARCH_QCOM || COMPILE_TEST
	depends on PM
	select VIDEOBUF2_DMA_CONTIG
	select V4L2_MEM2MEM_DEV
	help
	  This is a V4L2 mem2mem driver for the Qualcomm Video Processing
	  Engine (VPE) found in the MSM8260/MSM8660/APQ8060 SoCs.

	  The VPE provides hardware-accelerated NV12 scaling and rotation.

	  To compile this driver as a module, choose M here. The module
	  will be called qcom-vpe.
```

## drivers/misc/a6/Kconfig
```kconfig
# SPDX-License-Identifier: GPL-2.0-only
#
# Palm A6 Battery Controller Configuration
#

config A6
	tristate "Palm A6 battery controller"
	depends on I2C && OF
	select REGMAP_I2C
	help
	  Support for Palm A6 battery controllers used in HP TouchPad.
	  These are TI MSP430 microcontrollers providing battery monitoring,
	  power management, and Touchstone inductive charging support.

	  The driver provides battery information through the power_supply
	  class and firmware update capability via character device interface.

	  To compile this driver as a module, choose M here: the module
	  will be called a6.

config A6_I2C_SINGLE_BYTE
	bool "Enable A6 I2C single byte read"
	depends on A6
	help
	  Enable single byte I2C read operations for A6 driver.
	  This may be needed for compatibility with certain I2C controllers.

	  If unsure, say N.

config A6_I2C_SINGLE_BYTE_WRITE
	bool "Enable A6 I2C single byte write"
	depends on A6
	help
	  Enable single byte I2C write operations for A6 driver.
	  This may be needed for compatibility with certain I2C controllers.

	  If unsure, say N.
```

## drivers/misc/mediatek/spm/Kconfig
```kconfig
config MTK_SPM
	tristate "MTK SPM"
	help
	  This kernel config can be used to enable MTK QOS FRAMEWORK.
	  When enabling this option, BW Limiter and BW Bound Detector
	  will be enabled and set EMI hardware.
	  If unsure, say N.

config MTK_SPM_V0
	tristate "MTK SPM V0"
	help
	  This kernel config can be used to enable MTK SPM V0
	  for MT6765.

	  If unsure, say N.

config MTK_IDLE_BOOST
	tristate "MTK IDLE BOOST"
	help
	  This kernel config can be used to boost vcore to 0.7v when
	  enter idle for MT6768.

	  If unsure, say N.
```

## drivers/power/supply/a6/Kconfig
```kconfig
# SPDX-License-Identifier: GPL-2.0-only
#
# Palm A6 Battery Controller Configuration
#

config BATTERY_PALM_A6
	tristate "Palm A6 battery controller"
	depends on I2C && OF
	help
	  Support for the Palm A6 battery controller used in the HP TouchPad
	  (Tenderloin). The A6 is a TI MSP430 companion MCU that exposes
	  battery state (voltage, current, temperature, capacity, coulomb
	  counter) over I2C; this driver makes that state available through
	  the standard power_supply class.

	  To compile this driver as a module, choose M here: the module
	  will be called a6_battery.

config BATTERY_PALM_A6_I2C_SINGLE_BYTE
	bool "Use single-byte I2C reads for A6 register access"
	depends on BATTERY_PALM_A6
	help
	  Use single-byte I2C read transactions on every A6 register access
	  instead of the chained N-byte read the A6 firmware normally
	  expects. This is a workaround for I2C bus masters or PMICs that
	  cannot generate (or correctly handle) a repeated-START sequence
	  followed by an N-byte read, so the driver issues N independent
	  single-byte reads instead.

	  Only required on the legacy Palm PMIC-attached I2C bus topology.
	  If unsure, say N.

config BATTERY_PALM_A6_A2A_COMM
	tristate "Palm A6 legacy A2A comm interface (Tap-to-Share)"
	depends on BATTERY_PALM_A6 && AUXILIARY_BUS
	help
	  Re-exposes the legacy /dev/a6_N character device and
	  /sys/class/misc/a6_N/regs/ sysfs attributes that the
	  original webOS Tap-to-Share userspace (tap2shared) consumes.

	  This interface is NOT for upstream submission; it exists only
	  to keep legacy webOS userspace running on a mainline kernel.
	  Modern webOS / LuneOS userspace does not consume this
	  interface - they go through the standard power_supply class.

	  Say M here unless you intend to boot legacy webOS / use
	  Tap-to-Share between Palm/HP devices.
```
