## Documentation/devicetree/bindings/leds/ti,lm8502.yaml
```yaml
# SPDX-License-Identifier: GPL-2.0-only OR BSD-2-Clause
%YAML 1.2
---
$id: http://devicetree.org/schemas/leds/ti,lm8502.yaml#
$schema: http://devicetree.org/meta-schemas/core.yaml#

title: TI LM8502 LED Controller

maintainers:
  - webOS Community <webos-ports.org>

description: |
  The TI LM8502 is a multi-function LED controller featuring:
  - 10 individually controllable LED channels with current control
  - 3 hardware LED groups with group faders
  - 2 programmable engines for LED animation patterns
  - Vibrator/haptic feedback support (exposed as input force-feedback)
  - Camera flash (up to 600mA) and torch (up to 150mA) functionality
  - Interrupt output for engine synchronization

properties:
  compatible:
    const: ti,lm8502

  reg:
    maxItems: 1
    description: I2C address (typically 0x33)

  enable-gpios:
    maxItems: 1
    description: GPIO to enable/disable the chip

  interrupts:
    maxItems: 1
    description: Interrupt for engine completion notification

  ti,vibrator-invert:
    type: boolean
    description: Invert the vibrator direction output

  "#address-cells":
    const: 1

  "#size-cells":
    const: 0

patternProperties:
  "^led@[0-9]$":
    type: object
    $ref: common.yaml#
    unevaluatedProperties: false

    properties:
      reg:
        minimum: 0
        maximum: 9
        description: LED channel number (0-9 for D1-D10)

      ti,hw-group:
        $ref: /schemas/types.yaml#/definitions/uint32
        minimum: 0
        maximum: 3
        default: 0
        description: |
          Hardware group assignment for synchronized brightness control.
          0 = no group (individual control)
          1-3 = hardware groups using group faders

    required:
      - reg

required:
  - compatible
  - reg
  - "#address-cells"
  - "#size-cells"

additionalProperties: false

examples:
  - |
    #include <dt-bindings/gpio/gpio.h>
    #include <dt-bindings/interrupt-controller/irq.h>
    #include <dt-bindings/leds/common.h>

    i2c {
        #address-cells = <1>;
        #size-cells = <0>;

        led-controller@33 {
            compatible = "ti,lm8502";
            reg = <0x33>;

            enable-gpios = <&gpio 124 GPIO_ACTIVE_HIGH>;
            interrupt-parent = <&gpio>;
            interrupts = <42 IRQ_TYPE_EDGE_FALLING>;

            #address-cells = <1>;
            #size-cells = <0>;

            /* Keyboard backlight - all keys in hw-group 1 */
            led@0 {
                reg = <0>;
                function = LED_FUNCTION_KBD_BACKLIGHT;
                color = <LED_COLOR_ID_WHITE>;
                ti,hw-group = <1>;
            };

            /* Navigation gesture area LEDs */
            led@1 {
                reg = <1>;
                function = "navi-left";
                color = <LED_COLOR_ID_WHITE>;
            };

            led@2 {
                reg = <2>;
                function = "navi-center";
                color = <LED_COLOR_ID_WHITE>;
            };

            led@3 {
                reg = <3>;
                function = "navi-right";
                color = <LED_COLOR_ID_WHITE>;
            };
        };
    };
```

## Documentation/devicetree/bindings/media/i2c/aptina,mt9m113.yaml
```yaml
# SPDX-License-Identifier: (GPL-2.0-only OR BSD-2-Clause)
%YAML 1.2
---
$id: http://devicetree.org/schemas/media/i2c/aptina,mt9m113.yaml#
$schema: http://devicetree.org/meta-schemas/core.yaml#

title: Aptina MT9M113 1.3 Megapixel CMOS Digital Image Sensor

maintainers:
  - Herman van Hazendonk <github.com@herrie.org>

description: |-
  The Aptina MT9M113 is a 1.3 Megapixel CMOS digital image sensor with
  1280x1024 active pixels. It supports dual context operation:
  Context A (640x480 preview mode with binning) and Context B (1280x1024
  capture mode). It is programmable through an I2C interface and outputs
  image data over a 1-lane MIPI CSI-2 connection.

properties:
  compatible:
    const: aptina,mt9m113

  reg:
    description: I2C device address
    enum:
      - 0x3c
      - 0x48
      - 0x5d

  clocks:
    description: EXTCLK clock signal (24 MHz typical)
    maxItems: 1

  vdd-supply:
    description:
      Core digital voltage supply, 1.8V

  vddio-supply:
    description:
      I/O digital voltage supply, 1.8V or 2.8V

  vaa-supply:
    description:
      Analog voltage supply, 2.8V

  reset-gpios:
    description: |-
      Reference to the GPIO connected to the RESET_BAR pin, if any (active
      low).

  powerdown-gpios:
    description: |-
      Reference to the GPIO connected to the STANDBY/PWDN pin, if any (active
      high). When asserted, the sensor enters low-power standby mode.

  port:
    $ref: /schemas/graph.yaml#/$defs/port-base
    additionalProperties: false

    properties:
      endpoint:
        $ref: /schemas/media/video-interfaces.yaml#
        unevaluatedProperties: false

        properties:
          bus-type:
            const: 4
            description: MIPI CSI-2 D-PHY

          link-frequencies: true
          remote-endpoint: true
          data-lanes:
            minItems: 1
            maxItems: 1

        required:
          - bus-type
          - link-frequencies
          - data-lanes

    required:
      - endpoint

required:
  - compatible
  - reg
  - clocks
  - vdd-supply
  - vddio-supply
  - vaa-supply
  - port

additionalProperties: false

examples:
  - |
    #include <dt-bindings/gpio/gpio.h>
    #include <dt-bindings/media/video-interfaces.h>

    i2c0 {
        #address-cells = <1>;
        #size-cells = <0>;

        camera@3c {
            compatible = "aptina,mt9m113";
            reg = <0x3c>;

            clocks = <&mmcc 48>;

            reset-gpios = <&pm8058_gpio 29 GPIO_ACTIVE_LOW>;
            powerdown-gpios = <&pm8058_gpio 30 GPIO_ACTIVE_HIGH>;

            vddio-supply = <&pm8058_l15>;
            vdd-supply = <&pm8058_l15>;
            vaa-supply = <&pm8058_l14>;

            port {
                mt9m113_ep: endpoint {
                    bus-type = <MEDIA_BUS_TYPE_CSI2_DPHY>;
                    link-frequencies = /bits/ 64 <384000000>;
                    data-lanes = <1>;
                    remote-endpoint = <&csiphy1_ep>;
                };
            };
        };
    };
...
```

## Documentation/devicetree/bindings/media/i2c/st,vx6953.yaml
```yaml
# SPDX-License-Identifier: (GPL-2.0 OR BSD-2-Clause)
# Copyright (c) 2024 Linux community
%YAML 1.2
---
$id: http://devicetree.org/schemas/media/i2c/st,vx6953.yaml#
$schema: http://devicetree.org/meta-schemas/core.yaml#

title: STMicroelectronics VX6953 5.1MP EDOF Camera Sensor

maintainers:
  - Linux community

description: |-
  The STMicroelectronics VX6953 is a 5.1 megapixel EDOF (Extended Depth of
  Field) camera sensor module. It produces raw Bayer 5 Mpixel images at 15 fps
  in RAW10 format. The sensor supports CSI-2 data interface with 1 or 2 lanes.

  The VX6953 was used in devices such as the HP TouchPad (Opal) tablet as the
  rear camera.

properties:
  compatible:
    const: st,vx6953

  reg:
    maxItems: 1

  clocks:
    maxItems: 1
    description:
      Reference to the external clock. Must be 24 MHz.

  vana-supply:
    description:
      Analog power supply (2.8V).

  vdig-supply:
    description:
      Digital power supply (1.8V).

  vio-supply:
    description:
      I/O power supply (1.8V).

  powerdown-gpios:
    maxItems: 1
    description:
      Reference to the GPIO connected to the powerdown pin, if any.
      This is active high (sensor powered down when high).

  port:
    $ref: /schemas/graph.yaml#/$defs/port-base
    additionalProperties: false

    properties:
      endpoint:
        $ref: /schemas/media/video-interfaces.yaml#
        unevaluatedProperties: false

        properties:
          data-lanes:
            description:
              CSI lanes to use. The VX6953 supports 1 or 2 lanes.
            minItems: 1
            maxItems: 2
            items:
              enum: [1, 2]

          remote-endpoint: true

        required:
          - data-lanes

required:
  - compatible
  - reg
  - clocks
  - port

additionalProperties: false

examples:
  - |
    #include <dt-bindings/gpio/gpio.h>
    i2c {
        #address-cells = <1>;
        #size-cells = <0>;

        camera@20 {
            compatible = "st,vx6953";
            reg = <0x20>;
            clocks = <&cam_mclk>;
            vana-supply = <&cam_vana>;
            vdig-supply = <&cam_vdig>;
            vio-supply = <&cam_vio>;
            powerdown-gpios = <&tlmm 157 GPIO_ACTIVE_HIGH>;

            port {
                vx6953_ep: endpoint {
                    data-lanes = <1 2>;
                    remote-endpoint = <&csiphy0_ep>;
                };
            };
        };
    };
...
```

## Documentation/devicetree/bindings/media/qcom,msm8660-camss.yaml
```yaml
# SPDX-License-Identifier: (GPL-2.0 OR BSD-2-Clause)
%YAML 1.2
---
$id: http://devicetree.org/schemas/media/qcom,msm8660-camss.yaml#
$schema: http://devicetree.org/meta-schemas/core.yaml#

title: Qualcomm CAMSS ISP (MSM8660 / APQ8060)

maintainers:
  - Herman van Hazendonk <github.com@herrie.org>

description: |
  The CAMSS IP is a CSI decoder and ISP present on Qualcomm platforms.

  MSM8660 (and its application-processor variant APQ8060) integrate the
  first-generation VFE 3.1 front end. Unlike later platforms, the CSIPHY and
  CSID are a single unified hardware block per CSI port, so each CSID shares
  the register region and interrupt of the matching CSIPHY; only the CSIPHY
  exposes an interrupt. There is no ISPIF block.

select:
  properties:
    compatible:
      contains:
        const: qcom,msm8660-camss
  required:
    - compatible

properties:
  compatible:
    enum:
      - qcom,apq8060-camss
      - qcom,msm8660-camss

  reg:
    minItems: 3
    maxItems: 3

  reg-names:
    items:
      - const: vfe0
      - const: csiphy0
      - const: csiphy1

  interrupts:
    minItems: 3
    maxItems: 3

  interrupt-names:
    items:
      - const: vfe0
      - const: csiphy0
      - const: csiphy1

  clocks:
    minItems: 15
    maxItems: 15

  clock-names:
    items:
      - const: vfe
      - const: vfe_axi
      - const: vfe_ahb
      - const: vfe_csi0
      - const: vfe_csi1
      - const: csi_rdi
      - const: csi_pix
      - const: csi0_ahb
      - const: csi1_ahb
      - const: csi0_src
      - const: csi0
      - const: csi0_phy
      - const: csi1_src
      - const: csi1
      - const: csi1_phy

  interconnects:
    maxItems: 1

  interconnect-names:
    items:
      - const: vfe-mem

  power-domains:
    items:
      - description: VFE GDSC - Video Front End, Global Distributed Switch Controller.

  ports:
    $ref: /schemas/graph.yaml#/properties/ports

    description:
      CSI input ports. Port index matches the CSIPHY/CSID index.

    properties:
      port@0:
        $ref: /schemas/graph.yaml#/$defs/port-base
        unevaluatedProperties: false
        description:
          Input port for receiving CSI data on CSIPHY0.

        properties:
          endpoint:
            $ref: video-interfaces.yaml#
            unevaluatedProperties: false

            properties:
              data-lanes:
                description:
                  An array of physical data lanes indexes. Position of an entry
                  determines the logical lane number, while the value of an
                  entry indicates the physical lane index. Lane swapping is
                  supported.
                minItems: 1
                maxItems: 4

              bus-type:
                enum:
                  - 4 # MEDIA_BUS_TYPE_CSI2_DPHY

            required:
              - data-lanes

      port@1:
        $ref: /schemas/graph.yaml#/$defs/port-base
        unevaluatedProperties: false
        description:
          Input port for receiving CSI data on CSIPHY1.

        properties:
          endpoint:
            $ref: video-interfaces.yaml#
            unevaluatedProperties: false

            properties:
              data-lanes:
                minItems: 1
                maxItems: 4

              bus-type:
                enum:
                  - 4 # MEDIA_BUS_TYPE_CSI2_DPHY

            required:
              - data-lanes

required:
  - compatible
  - reg
  - reg-names
  - interrupts
  - interrupt-names
  - clocks
  - clock-names
  - interconnects
  - interconnect-names
  - power-domains

additionalProperties: false

examples:
  - |
    #include <dt-bindings/interrupt-controller/arm-gic.h>
    #include <dt-bindings/clock/qcom,mmcc-msm8660.h>
    #include <dt-bindings/interconnect/qcom,msm8660.h>

    camss: camss@4500000 {
        compatible = "qcom,msm8660-camss";

        reg = <0x04500000 0x1000>,
              <0x04800000 0x0400>,
              <0x04900000 0x0400>;
        reg-names = "vfe0", "csiphy0", "csiphy1";

        interrupts = <GIC_SPI 48 IRQ_TYPE_EDGE_RISING>,
                     <GIC_SPI 84 IRQ_TYPE_EDGE_RISING>,
                     <GIC_SPI 83 IRQ_TYPE_EDGE_RISING>;
        interrupt-names = "vfe0", "csiphy0", "csiphy1";

        clocks = <&mmcc VFE_CLK>,
                 <&mmcc VFE_AXI_CLK>,
                 <&mmcc VFE_AHB_CLK>,
                 <&mmcc VFE_CSI0_CLK>,
                 <&mmcc VFE_CSI1_CLK>,
                 <&mmcc CSI_RDI_CLK>,
                 <&mmcc CSI_PIX_CLK>,
                 <&mmcc CSI0_AHB_CLK>,
                 <&mmcc CSI1_AHB_CLK>,
                 <&mmcc CSI0_SRC>,
                 <&mmcc CSI0_CLK>,
                 <&mmcc CSI0_PHY_CLK>,
                 <&mmcc CSI1_SRC>,
                 <&mmcc CSI1_CLK>,
                 <&mmcc CSI1_PHY_CLK>;
        clock-names = "vfe",
                      "vfe_axi",
                      "vfe_ahb",
                      "vfe_csi0",
                      "vfe_csi1",
                      "csi_rdi",
                      "csi_pix",
                      "csi0_ahb",
                      "csi1_ahb",
                      "csi0_src",
                      "csi0",
                      "csi0_phy",
                      "csi1_src",
                      "csi1",
                      "csi1_phy";

        interconnects = <&mmss_fabric MMFAB_MAS_VFE &apps_fabric AFAB_SLV_EBI_CH0>;
        interconnect-names = "vfe-mem";

        power-domains = <&mmcc VFE_GDSC>;

        ports {
            #address-cells = <1>;
            #size-cells = <0>;

            port@1 {
                reg = <1>;
                camss_csi1_ep: endpoint {
                    bus-type = <4>; /* CSI2_DPHY */
                    data-lanes = <1>;
                    clock-lanes = <0>;
                    remote-endpoint = <&mt9m113_ep>;
                };
            };
        };
    };
```
