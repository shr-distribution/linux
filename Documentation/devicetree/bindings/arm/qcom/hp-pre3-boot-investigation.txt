## Documentation/devicetree/bindings/dma/qcom,adm.yaml
```yaml
# SPDX-License-Identifier: (GPL-2.0-only OR BSD-2-Clause)
%YAML 1.2
---
$id: http://devicetree.org/schemas/dma/qcom,adm.yaml#
$schema: http://devicetree.org/meta-schemas/core.yaml#

title: Qualcomm ADM DMA Controller

maintainers:
  - Christian Marangi <ansuelsmth@gmail.com>
  - Bjorn Andersson <bjorn.andersson@linaro.org>

description: |
  Qualcomm Application Data Mover (ADM) DMA controller. The ADM is a
  flow-controlled DMA engine used on pre-BAM Qualcomm SoCs (MSM7x30,
  MSM8x60, MSM8960, MSM8974, IPQ806x) to move bytes between system
  memory and on-chip peripherals (NAND, SDCC, HSUART, Crypto Engine,
  TSIF). Slave-side flow control is provided by per-peripheral CRCI
  (Client Rate Control Index) lines.

properties:
  compatible:
    enum:
      # Generic compatible. New device trees should use a SoC-specific
      # compatible instead so the driver can pick the right per-SoC
      # quirks (interconnect floor, master-SD ownership, probe-time
      # reset policy). The generic form is preserved for backwards
      # compatibility with existing IPQ806x deployments.
      - qcom,adm
      - qcom,adm-apq8060
      - qcom,adm-ipq8064
      - qcom,adm-mpq8064
      - qcom,adm-msm7x30
      - qcom,adm-msm8660
      - qcom,adm-msm8960
      - qcom,adm-msm8974

  reg:
    maxItems: 1

  interrupts:
    maxItems: 1

  "#dma-cells":
    # Cell 0: channel index (0-15)
    # Cell 1: CRCI index (0-15). 0 = no CRCI (memcpy-only) or
    #         consumer driver supplies CRCI at runtime via
    #         qcom_adm_peripheral_config (e.g. NAND, which switches
    #         CMD CRCI and DATA CRCI per submission).
    # Cell 2: CRCI MUX bit (0 or 1). Only meaningful on ADM3 hardware
    #         (MSM8X60); other SoCs ignore the value.
    const: 3

  clocks:
    minItems: 1
    items:
      - description: ADM core clock (required)
      - description: ADM iface (AHB) clock (optional)

  clock-names:
    minItems: 1
    items:
      - const: core
      - const: iface

  resets:
    items:
      - description: ADM reset
      - description: ADM PBUS reset
      - description: ADM CI[0] reset
      - description: ADM CI[1] reset
      - description: ADM CI[2] reset

  reset-names:
    items:
      - const: clk
      - const: pbus
      - const: c0
      - const: c1
      - const: c2

  qcom,ee:
    $ref: /schemas/types.yaml#/definitions/uint32
    description: |
      Execution Environment (Security Domain) index that Linux owns.
      Reads/writes to per-channel registers go through this SD's
      register window.
    minimum: 0
    maximum: 7

  qcom,owns-master-sd:
    type: boolean
    description: |
      Indicates that Linux owns the master SD and is permitted to
      write the per-channel CONF, CRCI_CONF0/1, CI_CONF, and DBG_ERR
      registers. When absent, the driver trusts whatever the
      bootloader / TrustZone programmed and will refuse master-SD
      writes (WARN_ON_ONCE).

  qcom,channels-aarm:
    $ref: /schemas/types.yaml#/definitions/uint32-array
    description: |
      List of channel indices that Linux may use (i.e. that this AARM
      owns). Channels not listed are treated as owned by another
      execution environment (modem, TrustZone) and are not registered
      with the dmaengine framework or touched at probe. If absent,
      the driver assumes all 16 channels are AARM-owned.
    minItems: 1
    maxItems: 16
    items:
      minimum: 0
      maximum: 15

  qcom,crci-defaults:
    $ref: /schemas/types.yaml#/definitions/uint32-matrix
    description: |
      Optional per-CRCI default values used when a slave-sg consumer
      does not override blk_size/mux via qcom_adm_peripheral_config.
      Each row: <crci blk_size mux>.
        crci     - CRCI index (0-15)
        blk_size - CRCI_CTL block-size code (0..5; 0 = 16 B, ..., 5 = 256 B)
        mux      - CRCI_CTL MUX_SEL value (0 or 1)
    items:
      items:
        - description: CRCI index
          minimum: 0
          maximum: 15
        - description: blk_size code
          minimum: 0
          maximum: 5
        - description: MUX_SEL
          minimum: 0
          maximum: 1

  interconnects:
    minItems: 1
    maxItems: 2
    description: |
      Interconnect path(s) from this ADM controller to system memory
      (EBI). Replaces the legacy ebi1_adm_clk voter. SoCs with two
      SFAB master ports (MSM8x60 ADM1) MUST declare both paths or one
      port will be RPM-ARB-starved under load.

  interconnect-names:
    minItems: 1
    items:
      - enum: [memory, adm-mem]
      - const: memory-p1

required:
  - compatible
  - reg
  - interrupts
  - "#dma-cells"
  - clocks
  - clock-names
  - resets
  - reset-names
  - qcom,ee

additionalProperties: false

examples:
  - |
    #include <dt-bindings/clock/qcom,gcc-ipq806x.h>
    #include <dt-bindings/reset/qcom,gcc-ipq806x.h>

    adm_dma: dma-controller@18300000 {
        compatible = "qcom,adm-ipq8064";
        reg = <0x18300000 0x100000>;
        interrupts = <0 170 0>;
        #dma-cells = <3>;

        clocks = <&gcc ADM0_CLK>,
                  <&gcc ADM0_PBUS_CLK>;
        clock-names = "core", "iface";

        resets = <&gcc ADM0_RESET>,
                  <&gcc ADM0_PBUS_RESET>,
                  <&gcc ADM0_C0_RESET>,
                  <&gcc ADM0_C1_RESET>,
                  <&gcc ADM0_C2_RESET>;
        reset-names = "clk", "pbus", "c0", "c1", "c2";
        qcom,ee = <0>;
        qcom,owns-master-sd;
    };

...
```

## Documentation/devicetree/bindings/input/touchscreen/cypress,cy8ctma300.yaml
```yaml
# SPDX-License-Identifier: (GPL-2.0-only OR BSD-2-Clause)
%YAML 1.2
---
$id: http://devicetree.org/schemas/input/touchscreen/cypress,cy8ctma300.yaml#
$schema: http://devicetree.org/meta-schemas/core.yaml#

title: Cypress CY8CTMA300 Capacitive Touchscreen Controller

maintainers:
  - webOS Community <webos-ports@webos-ports.org>

description: |
  The Cypress CY8CTMA300 is a capacitive touchscreen controller
  that supports up to 10 simultaneous touch points. It was used
  in devices like the HP Pre3 smartphone.

allOf:
  - $ref: touchscreen.yaml#

properties:
  compatible:
    const: cypress,cy8ctma300

  reg:
    maxItems: 1

  interrupts:
    maxItems: 1

  reset-gpios:
    maxItems: 1
    description: GPIO connected to the reset pin (active low)

  vdd-supply:
    description: Digital voltage supply

  vcpin-supply:
    description: Analog voltage supply

  touchscreen-size-x: true
  touchscreen-size-y: true
  touchscreen-fuzz-x: true
  touchscreen-fuzz-y: true
  touchscreen-inverted-x: true
  touchscreen-inverted-y: true
  touchscreen-swapped-x-y: true

required:
  - compatible
  - reg
  - interrupts

additionalProperties: false

examples:
  - |
    #include <dt-bindings/gpio/gpio.h>
    #include <dt-bindings/interrupt-controller/irq.h>

    i2c {
        #address-cells = <1>;
        #size-cells = <0>;

        touchscreen@24 {
            compatible = "cypress,cy8ctma300";
            reg = <0x24>;

            interrupt-parent = <&gpio>;
            interrupts = <85 IRQ_TYPE_EDGE_FALLING>;

            reset-gpios = <&gpio 128 GPIO_ACTIVE_LOW>;

            vdd-supply = <&vdd_touch>;
            vcpin-supply = <&vcpin_touch>;

            touchscreen-size-x = <480>;
            touchscreen-size-y = <800>;
        };
    };
```

## Documentation/devicetree/bindings/input/touchscreen/cypress,cy8ctma395-ts.yaml
```yaml
# SPDX-License-Identifier: (GPL-2.0-only OR BSD-2-Clause)
%YAML 1.2
---
$id: http://devicetree.org/schemas/input/touchscreen/cypress,cy8ctma395-ts.yaml#
$schema: http://devicetree.org/meta-schemas/core.yaml#

title: Cypress CY8CTMA395 Touchscreen (serdev)

maintainers:
  - Herrie <herrie@linuxhacker.ru>

description: |
  The Cypress CY8CTMA395 is a capacitive touchscreen controller used in
  the HP TouchPad tablet. It consists of a master CY8CTMA395 and five
  slave CY8CTMA375 chips providing a 30x40 capacitance matrix.

  The touchscreen sends raw capacitance data over UART at 4 Mbps.
  I2C is used for initialization and power management commands.

allOf:
  - $ref: touchscreen.yaml#

properties:
  compatible:
    const: cypress,cy8ctma395-ts

  i2c-bus:
    $ref: /schemas/types.yaml#/definitions/phandle
    description: Phandle to the I2C bus used for initialization commands

  reset-gpios:
    maxItems: 1
    description: GPIO connected to the XRES (reset) pin

  wake-gpios:
    maxItems: 1
    description: GPIO connected to the WAKE pin

  vdd-supply:
    description: Regulator for the touchscreen power supply

required:
  - compatible
  - i2c-bus
  - reset-gpios
  - wake-gpios
  - vdd-supply

unevaluatedProperties: false

examples:
  - |
    #include <dt-bindings/gpio/gpio.h>

    serial {
        touchscreen {
            compatible = "cypress,cy8ctma395-ts";
            i2c-bus = <&gsbi10_i2c>;
            reset-gpios = <&tlmm 70 GPIO_ACTIVE_LOW>;
            wake-gpios = <&tlmm 123 GPIO_ACTIVE_HIGH>;
            vdd-supply = <&pm8058_l19>;
        };
    };
```

## Documentation/devicetree/bindings/input/touchscreen/cypress,cy8ctma395.yaml
```yaml
# SPDX-License-Identifier: (GPL-2.0-only OR BSD-2-Clause)
%YAML 1.2
---
$id: http://devicetree.org/schemas/input/touchscreen/cypress,cy8ctma395.yaml#
$schema: http://devicetree.org/meta-schemas/core.yaml#

title: Cypress CY8CTMA395 Touchscreen

maintainers:
  - Herman van Hazendonk <github.com@herrie.org>

description: |
  The Cypress CY8CTMA395 is a capacitive touchscreen controller used in
  the HP TouchPad tablet. It consists of a master CY8CTMA395 and five
  slave CY8CTMA375 chips providing a 30x40 capacitance matrix.

  The controller is wired to the host over two distinct buses and is
  therefore described as two device-tree nodes sharing the same
  compatible:

    1. A serdev child of the host UART (the primary data path) over
       which the controller streams raw capacitance frames at 4 Mbps.
       This node carries the reset / wake GPIOs and the VDD supply
       phandles, plus a "cypress,i2c" phandle pointing at (2).

    2. An I2C client at address 0x67 under the I2C controller the
       controller is wired to. This node holds the standard "reg"
       property so the address is visible to i2cdetect / dt schema
       collision checking. The serdev side resolves the i2c_client
       through the cypress,i2c phandle and uses it for the
       initialisation and power-management register writes.

allOf:
  - $ref: touchscreen.yaml#

properties:
  compatible:
    const: cypress,cy8ctma395

  reg:
    description: I2C client address (0x67); present only on the I2C node
    maxItems: 1

  cypress,i2c:
    $ref: /schemas/types.yaml#/definitions/phandle
    description: |
      Phandle to the companion I2C client node for init / power-on
      register writes. Required on the serdev node, omitted on the
      I2C node.

  reset-gpios:
    maxItems: 1
    description: GPIO connected to the XRES (reset) pin (serdev node)

  wake-gpios:
    maxItems: 1
    description: GPIO connected to the WAKE pin (serdev node)

  vdd-supply:
    description: Regulator for the touchscreen power supply (serdev node)

required:
  - compatible

oneOf:
  - description: I2C node
    required:
      - reg
  - description: serdev node
    required:
      - cypress,i2c
      - reset-gpios
      - wake-gpios
      - vdd-supply

unevaluatedProperties: false

examples:
  - |
    #include <dt-bindings/gpio/gpio.h>

    i2c {
        #address-cells = <1>;
        #size-cells = <0>;

        cy8c_i2c: touchscreen@67 {
            compatible = "cypress,cy8ctma395";
            reg = <0x67>;
        };
    };

    serial {
        touchscreen {
            compatible = "cypress,cy8ctma395";
            cypress,i2c = <&cy8c_i2c>;
            reset-gpios = <&tlmm 70 GPIO_ACTIVE_LOW>;
            wake-gpios = <&tlmm 123 GPIO_ACTIVE_HIGH>;
            vdd-supply = <&pm8058_l19>;
        };
    };
```

## Documentation/devicetree/bindings/interconnect/qcom,msm8660.yaml
```yaml
# SPDX-License-Identifier: (GPL-2.0 OR BSD-2-Clause)
%YAML 1.2
---
$id: http://devicetree.org/schemas/interconnect/qcom,msm8660.yaml#
$schema: http://devicetree.org/meta-schemas/core.yaml#

title: Qualcomm MSM8x60 family Network-On-Chip interconnect

maintainers:
  - Herman van Hazendonk <github.com@herrie.org>

description:
  The Qualcomm MSM8x60 family (MSM8260/MSM8660/APQ8060) NoC is split into
  four fabrics (APPSS, System, MMSS, Daytona), each modelled as a separate
  interconnect provider.  All four bandwidth-arbitration tables and the
  associated fabric/EBI/SMI bus-clock votes are owned by the RPM firmware
  and reached through the qcom,rpm parent's shared-memory interface, so
  every fabric is a child node of the qcom,rpm node and inherits the
  RPM IPC channel through its parent.

properties:
  compatible:
    enum:
      - qcom,msm8660-apps-fabric
      - qcom,msm8660-system-fabric
      - qcom,msm8660-mmss-fabric
      - qcom,msm8660-daytona-fabric

  '#interconnect-cells':
    const: 1

required:
  - compatible
  - '#interconnect-cells'

additionalProperties: false

examples:
  - |
    #include <dt-bindings/interrupt-controller/arm-gic.h>

    rpm@104000 {
        compatible = "qcom,rpm-msm8660";
        reg = <0x00104000 0x1000>;
        qcom,ipc = <&l2cc 0x8 2>;

        interrupts = <GIC_SPI 19 4>, <GIC_SPI 21 4>, <GIC_SPI 22 4>;
        interrupt-names = "ack", "err", "wakeup";

        interconnect-afab {
            compatible = "qcom,msm8660-apps-fabric";
            #interconnect-cells = <1>;
        };
    };
...
```

## Documentation/devicetree/bindings/leds/backlight/ti,lm3528.yaml
```yaml
# SPDX-License-Identifier: GPL-2.0-only OR BSD-2-Clause
%YAML 1.2
---
$id: http://devicetree.org/schemas/leds/backlight/ti,lm3528.yaml#
$schema: http://devicetree.org/meta-schemas/core.yaml#

title: TI LM3528 Backlight Controller

maintainers:
  - webOS Community <webos-ports.org>

description: |
  The TI LM3528 is a dual-channel white LED driver with I2C interface
  for LCD backlight applications. It provides up to 30mA per channel.

allOf:
  - $ref: common.yaml#

properties:
  compatible:
    const: ti,lm3528

  reg:
    maxItems: 1
    description: I2C address of the device (typically 0x36)

  default-brightness:
    description: Initial brightness level (0-100)
    $ref: /schemas/types.yaml#/definitions/uint32
    minimum: 0
    maximum: 100
    default: 50

required:
  - compatible
  - reg

unevaluatedProperties: false

examples:
  - |
    i2c {
        #address-cells = <1>;
        #size-cells = <0>;

        backlight@36 {
            compatible = "ti,lm3528";
            reg = <0x36>;
            default-brightness = <50>;
        };
    };
```
