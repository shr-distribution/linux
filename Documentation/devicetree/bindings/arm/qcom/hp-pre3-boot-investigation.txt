## Documentation/devicetree/bindings/media/qcom,msm8660-rotator.yaml
```yaml
# SPDX-License-Identifier: (GPL-2.0-only OR BSD-2-Clause)
%YAML 1.2
---
$id: http://devicetree.org/schemas/media/qcom,msm8660-rotator.yaml#
$schema: http://devicetree.org/meta-schemas/core.yaml#

title: Qualcomm MSM8660 Image Rotator

maintainers:
  - Herman van Hazendonk <github.com@herrie.org>

description:
  The rotator is the MDP image-rotation block found on the
  MSM8260/MSM8660/APQ8060 family. It is exposed as a V4L2 mem2mem device
  that rotates (0/90/180/270) and flips RGB and pseudo-planar YUV frames.
  It also detiles the Qualcomm MMSS 64x32 "supertile" NV12 layout the VIDC
  decoder emits into linear NV12. The same block is present on all three
  SoCs of this die.

properties:
  compatible:
    enum:
      - qcom,msm8260-rotator
      - qcom,msm8660-rotator
      - qcom,apq8060-rotator

  reg:
    maxItems: 1

  interrupts:
    maxItems: 1

  clocks:
    maxItems: 3

  clock-names:
    items:
      - const: core
      - const: iface
      - const: axi

  power-domains:
    maxItems: 1

  iommus:
    maxItems: 1

  interconnects:
    maxItems: 1

  interconnect-names:
    items:
      - const: rotator-mem

required:
  - compatible
  - reg
  - interrupts
  - clocks
  - clock-names
  - power-domains
  - iommus

additionalProperties: false

examples:
  - |
    #include <dt-bindings/clock/qcom,mmcc-msm8660.h>
    #include <dt-bindings/interconnect/qcom,msm8660.h>
    #include <dt-bindings/interrupt-controller/arm-gic.h>

    rotator@4e00000 {
        compatible = "qcom,msm8660-rotator";
        reg = <0x04e00000 0x100000>;
        interrupts = <GIC_SPI 73 IRQ_TYPE_EDGE_RISING>;
        clocks = <&mmcc ROT_CLK>,
                 <&mmcc ROT_AHB_CLK>,
                 <&mmcc ROT_AXI_CLK>;
        clock-names = "core", "iface", "axi";
        power-domains = <&mmcc ROT_GDSC>;
        iommus = <&rot_iommu 0>;
        interconnects = <&mmss_fabric MMFAB_MAS_ROTATOR
                         &apps_fabric AFAB_SLV_EBI_CH0>;
        interconnect-names = "rotator-mem";
    };
```

## Documentation/devicetree/bindings/media/qcom,msm8660-vidc.yaml
```yaml
# SPDX-License-Identifier: (GPL-2.0-only OR BSD-2-Clause)
%YAML 1.2
---
$id: http://devicetree.org/schemas/media/qcom,msm8660-vidc.yaml#
$schema: http://devicetree.org/meta-schemas/core.yaml#

title: Qualcomm MSM8660 VIDC 1080p video codec

maintainers:
  - Herman van Hazendonk <github.com@herrie.org>

description:
  The VIDC ("1080p") block found on the MSM8660/APQ8060 family is a
  firmware-driven hardware video codec. An on-chip RISC core runs firmware
  fetched from the System Memory Interface (SMI) SRAM window and the driver
  exposes two V4L2 mem2mem devices, an H.264 decoder and encoder. The RISC
  addresses memory physically (no IOMMU), so its working buffers live in
  reserved-memory regions inside the SMI window it can reach.

properties:
  compatible:
    enum:
      - qcom,msm8660-vidc
      - qcom,apq8060-vidc

  reg:
    maxItems: 1

  interrupts:
    maxItems: 1

  clocks:
    maxItems: 5

  clock-names:
    items:
      - const: core
      - const: iface
      - const: axi
      - const: axi_a
      - const: axi_b

  power-domains:
    maxItems: 1

  interconnects:
    maxItems: 2

  interconnect-names:
    items:
      - const: video-smi
      - const: video-ebi

  memory-region:
    items:
      - description:
          Firmware carveout in the SMI window (no-map). The RISC fetches its
          firmware from this region's physical base.
      - description:
          SMI pool (shared-dma-pool) for the bitstream and decoded-picture
          buffers. The firmware addresses these relative to the firmware
          base, so the region must lie within the reachable SMI window.

  qcom,icc-bw-avg-kbps:
    $ref: /schemas/types.yaml#/definitions/uint32
    description:
      Average interconnect bandwidth (kilobytes/s) for the codec data path.
      The driver uses a built-in 1080p default when absent.

  qcom,icc-bw-peak-kbps:
    $ref: /schemas/types.yaml#/definitions/uint32
    description:
      Peak interconnect bandwidth (kilobytes/s) for the codec data path.
      The driver uses a built-in 1080p default when absent.

required:
  - compatible
  - reg
  - interrupts
  - clocks
  - clock-names
  - power-domains
  - memory-region

additionalProperties: false

examples:
  - |
    #include <dt-bindings/clock/qcom,mmcc-msm8660.h>
    #include <dt-bindings/interconnect/qcom,msm8660.h>
    #include <dt-bindings/interrupt-controller/arm-gic.h>

    video-codec@4400000 {
        compatible = "qcom,msm8660-vidc";
        reg = <0x04400000 0x100000>;
        interrupts = <GIC_SPI 49 IRQ_TYPE_LEVEL_HIGH>;
        clocks = <&mmcc VCODEC_CLK>,
                 <&mmcc VCODEC_AHB_CLK>,
                 <&mmcc VCODEC_AXI_CLK>,
                 <&mmcc VCODEC_AXI_A_CLK>,
                 <&mmcc VCODEC_AXI_B_CLK>;
        clock-names = "core", "iface", "axi", "axi_a", "axi_b";
        power-domains = <&mmcc VED_GDSC>;
        interconnects = <&mmss_fabric MMFAB_MAS_HD_CODEC_PORT0
                         &mmss_fabric MMFAB_SLV_SMI>,
                        <&mmss_fabric MMFAB_MAS_HD_CODEC_PORT0
                         &apps_fabric AFAB_SLV_EBI_CH0>;
        interconnect-names = "video-smi", "video-ebi";
        memory-region = <&vidc_fw_mem>, <&vidc_smipool_mem>;
        qcom,icc-bw-avg-kbps = <167936>;
        qcom,icc-bw-peak-kbps = <1340416>;
    };
```

## Documentation/devicetree/bindings/media/qcom,msm8660-vpe.yaml
```yaml
# SPDX-License-Identifier: (GPL-2.0-only OR BSD-2-Clause)
%YAML 1.2
---
$id: http://devicetree.org/schemas/media/qcom,msm8660-vpe.yaml#
$schema: http://devicetree.org/meta-schemas/core.yaml#

title: Qualcomm MSM8660 Video Processing Engine (VPE)

maintainers:
  - Herman van Hazendonk <herrie@herrie.org>

description:
  The VPE is the MDP "PPP" pixel pipeline found on the MSM8260/MSM8660/APQ8060
  family. It is exposed as a V4L2 mem2mem device that performs NV12 scaling
  and rotation. The same block is present on all three SoCs of this die.

properties:
  compatible:
    enum:
      - qcom,msm8260-vpe
      - qcom,msm8660-vpe
      - qcom,apq8060-vpe

  reg:
    maxItems: 1

  interrupts:
    maxItems: 1

  clocks:
    maxItems: 3

  clock-names:
    items:
      - const: core
      - const: axi
      - const: ahb

  power-domains:
    maxItems: 1

  iommus:
    maxItems: 1

  interconnects:
    maxItems: 1

  interconnect-names:
    items:
      - const: vpe-mem

required:
  - compatible
  - reg
  - interrupts
  - clocks
  - clock-names
  - power-domains
  - iommus

additionalProperties: false

examples:
  - |
    #include <dt-bindings/clock/qcom,mmcc-msm8660.h>
    #include <dt-bindings/interconnect/qcom,msm8660.h>
    #include <dt-bindings/interrupt-controller/arm-gic.h>

    video-processing@5300000 {
        compatible = "qcom,msm8660-vpe";
        reg = <0x05300000 0x100000>;
        interrupts = <GIC_SPI 47 IRQ_TYPE_LEVEL_HIGH>;
        clocks = <&mmcc VPE_CLK>,
                 <&mmcc VPE_AXI_CLK>,
                 <&mmcc VPE_AHB_CLK>;
        clock-names = "core", "axi", "ahb";
        power-domains = <&mmcc VPE_GDSC>;
        iommus = <&vpe_iommu 0>;
        interconnects = <&mmss_fabric MMFAB_MAS_VPE
                         &apps_fabric AFAB_SLV_EBI_CH0>;
        interconnect-names = "vpe-mem";
    };
```
