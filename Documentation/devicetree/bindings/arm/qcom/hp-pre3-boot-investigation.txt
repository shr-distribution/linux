## Documentation/devicetree/bindings/mmc/arm,pl18x.yaml
```yaml
# SPDX-License-Identifier: (GPL-2.0 OR BSD-2-Clause)
%YAML 1.2
---
$id: http://devicetree.org/schemas/mmc/arm,pl18x.yaml#
$schema: http://devicetree.org/meta-schemas/core.yaml#

title: ARM PrimeCell MultiMedia Card Interface (MMCI) PL180 and PL181

maintainers:
  - Linus Walleij <linusw@kernel.org>
  - Ulf Hansson <ulf.hansson@linaro.org>

description:
  The ARM PrimeCell MMCI PL180 and PL181 provides an interface for
  reading and writing to MultiMedia and SD cards alike. Over the years
  vendors have use the VHDL code from ARM to create derivative MMC/SD/SDIO
  host controllers with very similar characteristics.

allOf:
  - $ref: /schemas/arm/primecell.yaml#
  - $ref: mmc-controller.yaml#

# We need a select here so we don't match all nodes with 'arm,primecell'
select:
  properties:
    compatible:
      contains:
        enum:
          - arm,pl180
          - arm,pl181
          - arm,pl18x
  required:
    - compatible

properties:
  compatible:
    oneOf:
      - description: The first version of the block, simply called
          PL180 and found in the ARM Integrator IM/PD1 logic module.
        items:
          - const: arm,pl180
          - const: arm,primecell
      - description: The improved version of the block, found in the
          ARM Versatile and later reference designs. Further revisions
          exist but get detected at runtime by reading some magic numbers
          in the PrimeCell ID registers.
        items:
          - const: arm,pl181
          - const: arm,primecell
      - description: Wildcard entry that will let the operating system
          inspect the PrimeCell ID registers to determine which hardware
          variant of PL180 or PL181 this is.
        items:
          - const: arm,pl18x
          - const: arm,primecell
      - description: Entries for STMicroelectronics variant of PL18x.
        items:
          - enum:
              - st,stm32-sdmmc2
              - st,stm32mp25-sdmmc2
          - const: arm,pl18x
          - const: arm,primecell
      - description: Qualcomm SDCC v4 PrimeCell as wired on MSM8660 /
          APQ8060.  Selects the MSM8660-specific MMCI variant which
          enables the ADM exec_func atomic-submit hook, a 250 us
          DATACTRL settle delay, a 2x data timeout, and in-band SDIO
          IRQ routing.  Modern Qualcomm SoCs (MSM8916, MSM8974,
          SDM845, ...) do not need this and should use the generic
          arm,pl18x compatible.
        items:
          - const: qcom,msm8660-sdcc-v4
          - const: arm,pl18x
          - const: arm,primecell

  clocks:
    description: One or two clocks, the "apb_pclk" and the "MCLK"
      which is the core block clock. The names are not compulsory.
    minItems: 1
    maxItems: 2

  dmas:
    maxItems: 2

  dma-names:
    oneOf:
      - items:
          - const: tx
          - const: rx
      - items:
          - const: rx
          - const: tx

  access-controllers:
    minItems: 1
    maxItems: 2

  power-domains: true

  resets:
    maxItems: 1

  reg:
    description: the MMIO memory window must be exactly 4KB (0x1000) and the
      layout should provide the PrimeCell ID registers so that the device can
      be discovered. On ST Micro variants, a second register window may be
      defined if a delay block is present and used for tuning.

  interrupts:
    description: The first interrupt is the command interrupt and corresponds
      to the event at the end of a command. The second interrupt is the
      PIO (polled I/O) interrupt and occurs when the FIFO needs to be
      emptied as part of a bulk read from the card. Some variants have these
      two interrupts wired into the same line (logic OR) and in that case
      only one interrupt may be provided. The interrupt-names property is
      not used due to inconsistency of existing DTs regarding its content.
    deprecated: false
    minItems: 1
    maxItems: 2

  st,sig-dir-dat0:
    $ref: /schemas/types.yaml#/definitions/flag
    description: ST Micro-specific property, bus signal direction pins used for
      DAT[0].

  st,sig-dir-dat2:
    $ref: /schemas/types.yaml#/definitions/flag
    description: ST Micro-specific property, bus signal direction pins used for
      DAT[2].

  st,sig-dir-dat31:
    $ref: /schemas/types.yaml#/definitions/flag
    description: ST Micro-specific property, bus signal direction pins used for
      DAT[3] and DAT[1].

  st,sig-dir-dat74:
    $ref: /schemas/types.yaml#/definitions/flag
    description: ST Micro-specific property, bus signal direction pins used for
      DAT[7] and DAT[4].

  st,sig-dir-cmd:
    $ref: /schemas/types.yaml#/definitions/flag
    description: ST Micro-specific property, CMD signal direction used for
      pin CMD.

  st,sig-pin-fbclk:
    $ref: /schemas/types.yaml#/definitions/flag
    description: ST Micro-specific property, feedback clock FBCLK signal pin
      in use.

  st,sig-dir:
    $ref: /schemas/types.yaml#/definitions/flag
    description: ST Micro-specific property, signal direction polarity used for
      pins CMD, DAT[0], DAT[1], DAT[2] and DAT[3].

  st,neg-edge:
    $ref: /schemas/types.yaml#/definitions/flag
    description: ST Micro-specific property, data and command phase relation,
      generated on the sd clock falling edge.

  st,use-ckin:
    $ref: /schemas/types.yaml#/definitions/flag
    description: ST Micro-specific property, use CKIN pin from an external
      driver to sample the receive data (for example with a voltage switch
      transceiver).

  st,cmd-gpios:
    maxItems: 1
    description:
      The GPIO matching the CMD pin.

  st,ck-gpios:
    maxItems: 1
    description:
      The GPIO matching the CK pin.

  st,ckin-gpios:
    maxItems: 1
    description:
      The GPIO matching the CKIN pin.

  interconnects:
    minItems: 1
    maxItems: 2

  interconnect-names:
    minItems: 1
    maxItems: 2
    items:
      enum: [mmc-mem, mmc-cfg, sdc]

  qcom,sdcc-crci:
    $ref: /schemas/types.yaml#/definitions/uint32
    description:
      Client Rate Control Interface identifier the qcom_adm DMA channel
      uses to handshake with this SDCC FIFO.  Required on MSM8x60-class
      boards where ADM (not BAM) is the DMA back-end; the value must
      match the SDCC-instance row in the SoC's ADM CRCI table (e.g.
      sdcc1=2/3, sdcc2=4/5, sdcc3=6/7, sdcc4=8/9 on MSM8660).  Without
      it qcom_adm has no peripheral handshake signal and the channel
      either deadlocks or overflows the FIFO.

  qcom,datactrl-first:
    type: boolean
    description:
      Program SDCC DATACTRL before writing CMD register, matching the
      legacy Qualcomm msm_sdcc driver behaviour on the MSM8x60 / APQ8060
      SDCC v4 controller.  Required for SDIO (mmc1) on MSM8660 where the
      AR6003 + ADM1 race condition is otherwise visible -- the data
      path state machine arms before the command starts so the first
      CMD53 transfer does not miss the first FIFO fill.  Default-off
      because it changes register-write ordering and is not safe on
      every Qualcomm SDCC instance.

  qcom,dummy52-required:
    type: boolean
    description:
      Inject a dummy SDIO CMD52 (CCCR register 0 read on function 0)
      after every CMD53/CMD54 WRITE so the SDCC v4 DPSM residual state
      gets drained before the next command on the bus.  Without this,
      the next CMD on the same SDCC instance can see DATACRCFAIL or
      CMDTIMEOUT.  Only the SDCC instance(s) that carry SDIO traffic
      need this; eMMC-only instances do not.

  qcom,max-req-kb:
    $ref: /schemas/types.yaml#/definitions/uint32
    description:
      Cap mmc->max_req_size (in KB) to constrain the size of a single
      DMA request.  Used on MSM8660 to keep individual qcom_adm
      transfers below the AHB / fabric back-pressure threshold that
      otherwise triggers RXOVERRUN under concurrent eMMC + WiFi load.
      Typical value 64 (= 64 KB).  Default (property absent) keeps the
      MMC-core inferred maximum.
    minimum: 4
    maximum: 1024

dependencies:
  st,cmd-gpios: [ "st,use-ckin" ]
  st,ck-gpios: [ "st,use-ckin" ]
  st,ckin-gpios: [ "st,use-ckin" ]

unevaluatedProperties: false

required:
  - compatible
  - reg
  - interrupts

examples:
  - |
    #include <dt-bindings/interrupt-controller/irq.h>
    #include <dt-bindings/gpio/gpio.h>

    mmc@5000 {
      compatible = "arm,pl180", "arm,primecell";
      reg = <0x5000 0x1000>;
      interrupts-extended = <&vic 22 &sic 1>;
      clocks = <&xtal24mhz>, <&pclk>;
      clock-names = "mclk", "apb_pclk";
    };

  - |
    #include <dt-bindings/interrupt-controller/irq.h>

    mmc@80126000 {
      compatible = "arm,pl18x", "arm,primecell";
      reg = <0x80126000 0x1000>;
      interrupts = <0 60 IRQ_TYPE_LEVEL_HIGH>;
      dmas = <&dma 29 0 0x2>, <&dma 29 0 0x0>;
      dma-names = "rx", "tx";
      clocks = <&prcc_kclk 1 5>, <&prcc_pclk 1 5>;
      clock-names = "sdi", "apb_pclk";
      max-frequency = <100000000>;
      bus-width = <4>;
      cap-sd-highspeed;
      cap-mmc-highspeed;
      cd-gpios = <&gpio2 31 0x4>;
      st,sig-dir-dat0;
      st,sig-dir-dat2;
      st,sig-dir-cmd;
      st,sig-pin-fbclk;
      vmmc-supply = <&ab8500_ldo_aux3_reg>;
      vqmmc-supply = <&vmmci>;
    };

  - |
    mmc@101f6000 {
      compatible = "arm,pl18x", "arm,primecell";
      reg = <0x101f6000 0x1000>;
      clocks = <&sdiclk>, <&pclksdi>;
      clock-names = "mclk", "apb_pclk";
      interrupts = <22>;
      max-frequency = <400000>;
      bus-width = <4>;
      cap-mmc-highspeed;
      cap-sd-highspeed;
      full-pwr-cycle;
      st,sig-dir-dat0;
      st,sig-dir-dat2;
      st,sig-dir-dat31;
      st,sig-dir-cmd;
      st,sig-pin-fbclk;
      vmmc-supply = <&vmmc_regulator>;
    };

  - |
    mmc@52007000 {
      compatible = "arm,pl18x", "arm,primecell";
      arm,primecell-periphid = <0x10153180>;
      reg = <0x52007000 0x1000>;
      interrupts = <49>;
      clocks = <&rcc 0>;
      clock-names = "apb_pclk";
      resets = <&rcc 1>;
      cap-sd-highspeed;
      cap-mmc-highspeed;
      max-frequency = <120000000>;
    };

  - |
    /* Qualcomm SDCC v4 on MSM8660 / APQ8060, SDIO instance (WiFi). */
    mmc@121c0000 {
      compatible = "qcom,msm8660-sdcc-v4", "arm,pl18x", "arm,primecell";
      arm,primecell-periphid = <0x00051180>;
      reg = <0x121c0000 0x8000>;
      interrupts = <0 187 0x4>;
      clocks = <&gcc 0>, <&gcc 1>;
      clock-names = "mclk", "apb_pclk";
      dmas = <&adm_dma 8>, <&adm_dma 9>;
      dma-names = "rx", "tx";
      qcom,sdcc-crci = <8>;
      qcom,datactrl-first;
      qcom,dummy52-required;
      qcom,max-req-kb = <64>;
      bus-width = <4>;
      non-removable;
      cap-sdio-irq;
    };
```

## Documentation/devicetree/bindings/net/bluetooth/palm,bcm4329-bcsp.yaml
```yaml
# SPDX-License-Identifier: (GPL-2.0-only OR BSD-2-Clause)
%YAML 1.2
---
$id: http://devicetree.org/schemas/net/bluetooth/palm,bcm4329-bcsp.yaml#
$schema: http://devicetree.org/meta-schemas/core.yaml#

title: HP/Palm BCM4329 Bluetooth (BCSP protocol)

maintainers:
  - Herman van Hazendonk <github.com@herrie.org>

description: |
  HP TouchPad / Pre family BCM4329 Bluetooth chip wired to a UART and
  driven by the hci_bcsp line-discipline / serdev (BCSP, not standard
  H4 / BCM, so a palm-specific compatible is required).

  The block consumes a long list of PSKEY (Persistent-Store Key) values
  that the driver injects into the chip during link bring-up; they are
  declared here as 16-bit /bits/ 16 arrays.

allOf:
  - $ref: /schemas/serial/serial-peripheral-props.yaml#
  - $ref: bluetooth-controller.yaml#

properties:
  compatible:
    const: palm,bcm4329-bcsp

  shutdown-gpios:
    maxItems: 1
    description: BT_POWER GPIO (active high).

  device-wakeup-gpios:
    maxItems: 1
    description: BT_WAKE GPIO (active high).

  reset-gpios:
    maxItems: 1
    description: BT_RST_N GPIO (active low).

  interrupts:
    maxItems: 1
    description: Host-wake interrupt from the BCM4329 (HOST_WAKE_BT).

  interrupt-names:
    items:
      - const: host-wakeup

  vddio-supply: true
  vbat-supply: true

  clocks:
    maxItems: 1
    description: 32 kHz sleep clock for the BCM4329 lpo input.

  clock-names:
    items:
      - const: lpo

  init-speed:
    $ref: /schemas/types.yaml#/definitions/uint32
    description: Bring-up UART speed before reconfiguration (baud).

  max-speed: true

  local-bd-address:
    $ref: /schemas/types.yaml#/definitions/uint8-array
    maxItems: 6

  brcm,bt-pcm-int-params:
    $ref: /schemas/types.yaml#/definitions/uint8-array
    description: BT PCM interface configuration bytes.

  # 16-bit configuration scalars (PSKEY 0x000e .. 0x025d).
  brcm,ana-freq: { $ref: /schemas/types.yaml#/definitions/uint16 }
  brcm,ana-ftrim: { $ref: /schemas/types.yaml#/definitions/uint16 }
  brcm,deep-sleep: { $ref: /schemas/types.yaml#/definitions/uint16 }
  brcm,default-tx-power: { $ref: /schemas/types.yaml#/definitions/uint16 }
  brcm,default-tx-power-no-rssi: { $ref: /schemas/types.yaml#/definitions/uint16 }
  brcm,enc-key-min: { $ref: /schemas/types.yaml#/definitions/uint16 }
  brcm,hci-max-acl: { $ref: /schemas/types.yaml#/definitions/uint16 }
  brcm,hci-max-sco: { $ref: /schemas/types.yaml#/definitions/uint16 }
  brcm,host-interface: { $ref: /schemas/types.yaml#/definitions/uint16 }
  brcm,max-tx-power: { $ref: /schemas/types.yaml#/definitions/uint16 }
  brcm,max-tx-power-no-rssi: { $ref: /schemas/types.yaml#/definitions/uint16 }
  brcm,uart-baudrate: { $ref: /schemas/types.yaml#/definitions/uint16 }

  # TouchPad-specific 16-bit PSKEYs (single-value)
  brcm,pskey-00f6: { $ref: /schemas/types.yaml#/definitions/uint16 }
  brcm,pskey-0394: { $ref: /schemas/types.yaml#/definitions/uint16 }
  brcm,pskey-03d4: { $ref: /schemas/types.yaml#/definitions/uint16 }

  # PSKEY arrays (16-bit words).
  brcm,tx-power-table:
    $ref: /schemas/types.yaml#/definitions/uint16-array

patternProperties:
  "^brcm,pskey-[0-9a-f]{4}$":
    $ref: /schemas/types.yaml#/definitions/uint16-array
    description: PSKEY value as 16-bit words (per TouchPad RF calibration).

required:
  - compatible

unevaluatedProperties: false
```
