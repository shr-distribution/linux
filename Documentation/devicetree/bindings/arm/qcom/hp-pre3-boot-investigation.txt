## Documentation/devicetree/bindings/phy/qcom,usb-hs-phy.yaml
```yaml
# SPDX-License-Identifier: GPL-2.0-only
%YAML 1.2
---
$id: http://devicetree.org/schemas/phy/qcom,usb-hs-phy.yaml#
$schema: http://devicetree.org/meta-schemas/core.yaml#

title: Qualcomm's USB HS PHY

maintainers:
  - Bjorn Andersson <bjorn.andersson@linaro.org>

allOf:
  - if:
      properties:
        compatible:
          contains:
            enum:
              - qcom,usb-hs-phy-apq8064
              - qcom,usb-hs-phy-msm8660
              - qcom,usb-hs-phy-msm8960
    then:
      # On these older parts the PHY POR reset is optional: chipidea
      # ci_hdrc_msm currently lacks the full controller-level link-reset
      # sequence (USBCMD_RESET + PORTSC=0x80000000) that must surround
      # the PHY POR + settle to keep ULPI vendor writes from landing on
      # a re-syncing link. Boards may therefore omit resets entirely and
      # rely on bootloader/state-machine initialization. When present,
      # only the POR reset is wired.
      properties:
        resets:
          maxItems: 1

        reset-names:
          const: por
    else:
      properties:
        resets:
          minItems: 2
          maxItems: 2

        reset-names:
          items:
            - const: phy
            - const: por
      required:
        - resets
        - reset-names

properties:
  compatible:
    items:
      - enum:
          - qcom,usb-hs-phy-apq8064
          - qcom,usb-hs-phy-msm8226
          - qcom,usb-hs-phy-msm8660
          - qcom,usb-hs-phy-msm8916
          - qcom,usb-hs-phy-msm8960
          - qcom,usb-hs-phy-msm8974
      - const: qcom,usb-hs-phy

  clocks:
    minItems: 2
    maxItems: 2

  clock-names:
    maxItems: 2
    contains:
      items:
        - const: ref
        - const: sleep

  resets: true

  reset-names: true

  v1p8-supply: true

  v3p3-supply: true

  extcon: true

  "#phy-cells":
    const: 0

  qcom,init-seq:
    $ref: /schemas/types.yaml#/definitions/uint8-matrix
    description: >
      Sequence of ULPI address and value pairs to
      program into the ULPI_EXT_VENDOR_SPECIFIC area.
      This is related to Device Mode Eye Diagram test.
    maxItems: 32 # no hard limit
    items:
      items:
        - description: >
            the address is offset from the ULPI_EXT_VENDOR_SPECIFIC address
        - description: value

  qcom,vendor-init-seq:
    $ref: /schemas/types.yaml#/definitions/uint8-array
    description: >
      Flat sequence of raw ULPI address/value byte pairs written after
      the PHY reset. Each pair is two consecutive bytes:
      [addr0, val0, addr1, val1, ...]. Total length must be even and
      no more than 64 bytes (32 pairs). Unlike qcom,init-seq the
      address field is not offset by ULPI_EXT_VENDOR_SPECIFIC, so this
      property can reach the standard ULPI vendor range (0x30-0x3f) —
      used on MSM8x60-class hardware to program pre-emphasis, HS
      driver slope and CDR auto-reset bits the legacy msm_otg driver
      used to set via platform data.
    maxItems: 64

required:
  - clocks
  - clock-names
  - "#phy-cells"

additionalProperties: false

examples:
  - |
    otg: usb-controller {
      #reset-cells = <1>;

      ulpi {
        phy {
          compatible = "qcom,usb-hs-phy-msm8974", "qcom,usb-hs-phy";
          #phy-cells = <0>;
          clocks = <&clk 0>, <&clk 258>;
          clock-names = "ref", "sleep";
          resets = <&gcc 10>, <&otg 0>;
          reset-names = "phy", "por";
          v3p3-supply = <&pm8941_l24>;
          v1p8-supply = <&pm8941_l6>;
          extcon = <&smbb>;
          qcom,init-seq = /bits/ 8 <0x1 0x63>;
        };
      };
    };
```

## Documentation/devicetree/bindings/power/supply/palm,a6-battery.yaml
```yaml
# SPDX-License-Identifier: (GPL-2.0-only OR BSD-2-Clause)
%YAML 1.2
---
$id: http://devicetree.org/schemas/power/supply/palm,a6-battery.yaml#
$schema: http://devicetree.org/meta-schemas/core.yaml#

title: Palm A6 battery / embedded controller

maintainers:
  - Herman van Hazendonk <github.com@herrie.org>

description:
  The Palm A6 is a TI MSP430-based embedded controller used on the HP
  TouchPad (Tenderloin) for battery monitoring, power management and
  Touchstone inductive charging. The host communicates with the A6 over
  I2C.

  Some boards (TouchPad 4G) carry two A6 controllers at distinct I2C
  addresses; each instance is described as a separate node, distinguished
  by its reg address.

properties:
  compatible:
    const: palm,a6-battery

  reg:
    maxItems: 1

  interrupts:
    maxItems: 1
    description:
      Edge-falling interrupt asserted by the A6 when it has battery
      status, charger status or wake events to report.

  wakeup-gpios:
    maxItems: 1
    description:
      Host-driven GPIO used to wake the A6 from its own low-power
      state before issuing commands.

  pinctrl-names: true
  pinctrl-0: true

  wakeup-source: true

required:
  - compatible
  - reg
  - interrupts
  - wakeup-gpios

additionalProperties: false

examples:
  - |
    #include <dt-bindings/gpio/gpio.h>
    #include <dt-bindings/interrupt-controller/irq.h>

    i2c {
        #address-cells = <1>;
        #size-cells = <0>;

        battery@31 {
            compatible = "palm,a6-battery";
            reg = <0x31>;

            wakeup-gpios = <&tlmm 155 GPIO_ACTIVE_HIGH>;

            interrupt-parent = <&tlmm>;
            interrupts = <37 IRQ_TYPE_EDGE_FALLING>;
            wakeup-source;
        };
    };
```

## Documentation/devicetree/bindings/remoteproc/qcom,msm8660-lpass-pil.yaml
```yaml
# SPDX-License-Identifier: (GPL-2.0 OR BSD-2-Clause)
%YAML 1.2
---
$id: http://devicetree.org/schemas/remoteproc/qcom,msm8660-lpass-pil.yaml#
$schema: http://devicetree.org/meta-schemas/core.yaml#

title: Qualcomm MSM8660/APQ8060 LPASS QDSP6v2 Peripheral Image Loader

maintainers:
  - Bjorn Andersson <andersson@kernel.org>

description:
  This document defines the binding for the component that loads and boots
  firmware on the Qualcomm LPASS (Low Power Audio Subsystem) QDSP6v2 core
  found on MSM8660 and APQ8060 platforms.

properties:
  compatible:
    enum:
      - qcom,msm8660-lpass-pil
      - qcom,apq8060-lpass-pil

  reg:
    items:
      - description: LCC (LPASS Clock Controller) registers
      - description: QDSP6SS (QDSP6 Subsystem) registers

  reg-names:
    items:
      - const: lcc
      - const: qdsp6ss

  clocks:
    items:
      - description: PLL4 (LPASS PLL) clock from LCC

  clock-names:
    items:
      - const: pll

  firmware-name:
    maxItems: 1
    description:
      Relative firmware image path for the LPASS QDSP6 core. The firmware
      uses the split format with a .mdt metadata file and .bXX segment files.

  memory-region:
    maxItems: 1
    description:
      Reserved memory region for the LPASS QDSP6 firmware and data.

required:
  - compatible
  - reg
  - reg-names
  - clocks
  - clock-names
  - firmware-name
  - memory-region

additionalProperties: false

examples:
  - |
    #include <dt-bindings/clock/qcom,lcc-msm8660.h>

    reserved-memory {
        #address-cells = <1>;
        #size-cells = <1>;
        ranges;

        lpass_mem: lpass@8f000000 {
            reg = <0x8f000000 0x500000>;
            no-map;
        };
    };

    remoteproc@28800000 {
        compatible = "qcom,apq8060-lpass-pil";
        reg = <0x28000000 0x1000>,
              <0x28800000 0x1000>;
        reg-names = "lcc", "qdsp6ss";

        clocks = <&lcc PLL4>;
        clock-names = "pll";

        firmware-name = "q6.mdt";
        memory-region = <&lpass_mem>;
    };
```

## Documentation/devicetree/bindings/serial/qcom,msm-uartdm.yaml
```yaml
# SPDX-License-Identifier: GPL-2.0 OR BSD-2-Clause
%YAML 1.2
---
$id: http://devicetree.org/schemas/serial/qcom,msm-uartdm.yaml#
$schema: http://devicetree.org/meta-schemas/core.yaml#

title: Qualcomm MSM Serial UARTDM

maintainers:
  - Andy Gross <agross@kernel.org>
  - Bjorn Andersson <bjorn.andersson@linaro.org>
  - Krzysztof Kozlowski <krzk@kernel.org>

description: |
  The MSM serial UARTDM hardware is designed for high-speed use cases where the
  transmit and/or receive channels can be offloaded to a dma-engine. From a
  software perspective it's mostly compatible with the MSM serial UART except
  that it supports reading and writing multiple characters at a time.

  Note:: Aliases may be defined to ensure the correct ordering of the UARTs.
  The alias serialN will result in the UART being assigned port N.  If any
  serialN alias exists, then an alias must exist for each enabled UART.  The
  serialN aliases should be in a .dts file instead of in a .dtsi file.

properties:
  compatible:
    items:
      - enum:
          - qcom,msm-uartdm-v1.1
          - qcom,msm-uartdm-v1.2
          - qcom,msm-uartdm-v1.3
          - qcom,msm-uartdm-v1.4
      - const: qcom,msm-uartdm

  clocks:
    maxItems: 2

  clock-names:
    items:
      - const: core
      - const: iface

  dmas:
    minItems: 1
    maxItems: 2

  dma-names:
    minItems: 1
    maxItems: 2
    items:
      enum: [tx, rx]

  interconnects:
    maxItems: 1

  interrupts:
    maxItems: 1

  operating-points-v2: true

  power-domains:
    maxItems: 1

  qcom,rx-crci:
    $ref: /schemas/types.yaml#/definitions/uint32
    description:
      Identificator for Client Rate Control Interface to be used with RX DMA
      channel. Required when using DMA for reception with UARTDM v1.3 and
      below.

  qcom,tx-crci:
    $ref: /schemas/types.yaml#/definitions/uint32
    description:
      Identificator for Client Rate Control Interface to be used with TX DMA
      channel. Required when using DMA for transmission with UARTDM v1.3 and
      below.

  qcom,startup-mux-glitch:
    type: boolean
    description:
      At port-open, briefly flip the UART pins to a "gpio" pinctrl state and
      back. Used to wake a power-gated peer's UART RX (e.g. CSR BlueCore
      Bluetooth chips on HP TouchPad). Requires a "gpio" pinctrl state on
      the same UART node.

  reg:
    minItems: 1
    items:
      - description: Main control registers
      - description: An optional second register location shall specify the GSBI control region.

patternProperties:
  "^touchscreen$":
    type: object
    description:
      Serdev-attached touchscreen child. Used on platforms where the touch
      controller streams data over UART rather than a dedicated bus
      (e.g. Cypress CY8CTMA395 on HP TouchPad).
    additionalProperties: true
    required:
      - compatible

required:
  - compatible
  - clock-names
  - clocks
  - interrupts
  - reg

allOf:
  - $ref: /schemas/serial/serial.yaml#

  - if:
      properties:
        compatible:
          contains:
            const: qcom,msm-uartdm-v1.3
    then:
      properties:
        reg:
          minItems: 2
    else:
      properties:
        reg:
          maxItems: 1

unevaluatedProperties: false

examples:
  - |
    #include <dt-bindings/interconnect/qcom,msm8996.h>
    #include <dt-bindings/interrupt-controller/arm-gic.h>
    #include <dt-bindings/power/qcom-rpmpd.h>

    serial@f991e000 {
        compatible = "qcom,msm-uartdm-v1.4", "qcom,msm-uartdm";
        reg = <0xf991e000 0x1000>;
        interrupts = <GIC_SPI 108 IRQ_TYPE_LEVEL_HIGH>;
        clocks = <&blsp1_uart2_apps_cxc>, <&blsp1_ahb_cxc>;
        clock-names = "core", "iface";
        dmas = <&dma0 0>, <&dma0 1>;
        dma-names = "tx", "rx";
        power-domains = <&rpmpd MSM8996_VDDCX>;
        operating-points-v2 = <&uart_opp_table>;
        interconnects = <&pnoc MASTER_BLSP_1 &bimc SLAVE_EBI_CH0>;
    };
```

## Documentation/devicetree/bindings/soc/qcom/qcom,msm8660-mpm.yaml
```yaml
# SPDX-License-Identifier: (GPL-2.0-only OR BSD-2-Clause)
%YAML 1.2
---
$id: http://devicetree.org/schemas/soc/qcom/qcom,msm8660-mpm.yaml#
$schema: http://devicetree.org/meta-schemas/core.yaml#

title: Qualcomm MSM8660 / APQ8060 MPM wake-source controller

maintainers:
  - Herman van Hazendonk <github.com@herrie.org>

description: |
  The MSM Power Manager (MPM) on MSM8660 is an always-on hardware block
  that keeps a small set of wake sources alive while the application
  processor is powered down for cpuidle Power Collapse or
  suspend-to-RAM. On MSM8660 / APQ8060 the vMPM registers live INSIDE
  the RPM's 4 KB control block (RPM_BASE + 0x9d8 for request regs,
  RPM_BASE + 0xdf8 for status), with notification of new wake-source
  configuration delivered via a single-bit write to the GCC block.

  This binding is MSM8660-specific. Newer Qualcomm SoCs (sm6375 etc.)
  use the qcom,mpm binding (drivers/irqchip/irq-qcom-mpm.c) which
  assumes a dedicated MPM SRAM region and a mailbox controller (IPCC)
  for wake notification — neither holds on MSM8660.

properties:
  compatible:
    const: qcom,msm8660-mpm

  interrupts:
    maxItems: 1
    description:
      IPC IRQ raised by MPM to wake the application processor when one
      of the enabled wake sources fires. On MSM8660 this is the
      RPM_SCSS_CPU0_GP_MEDIUM_IRQ (GIC SPI 20).

  qcom,rpm-syscon:
    $ref: /schemas/types.yaml#/definitions/phandle
    description:
      Phandle to the RPM control block exposed as a syscon. The vMPM
      registers are at fixed offsets within this block.

  qcom,mpm-request-offset:
    $ref: /schemas/types.yaml#/definitions/uint32
    description: |
      Offset within the RPM syscon where the four MPM request registers
      live (ENABLE, DETECT_CTL, POLARITY, CLEAR). On MSM8660 this is
      0x9d8.

  qcom,mpm-status-offset:
    $ref: /schemas/types.yaml#/definitions/uint32
    description: |
      Offset within the RPM syscon where the MPM status register
      (PENDING) lives. On MSM8660 this is 0xdf8.

  qcom,ipc:
    $ref: /schemas/types.yaml#/definitions/phandle-array
    items:
      - description: phandle to a syscon node
      - description: register offset within the syscon
      - description: bit position to set when triggering MPM
    description: |
      Three-cell IPC handshake: writing BIT(bit) at the given offset of
      the referenced syscon nudges MPM to re-read its request registers.
      On MSM8660 this targets the GCC block (l2cc syscon) at offset
      0x008 bit 1, matching legacy MSM_MPM_APPS_IPC =
      (MSM_GCC_BASE + 0x008), MSM_MPM_APPS_IPC_MPM = BIT(1).

required:
  - compatible
  - interrupts
  - qcom,rpm-syscon
  - qcom,mpm-request-offset
  - qcom,mpm-status-offset
  - qcom,ipc

additionalProperties: false

examples:
  - |
    #include <dt-bindings/interrupt-controller/arm-gic.h>

    soc {
        #address-cells = <1>;
        #size-cells = <1>;

        msm8660_mpm: msm8660-mpm {
            compatible = "qcom,msm8660-mpm";
            qcom,rpm-syscon = <&rpm>;
            qcom,mpm-request-offset = <0x9d8>;
            qcom,mpm-status-offset = <0xdf8>;
            qcom,ipc = <&l2cc 0x8 1>;
            interrupts = <GIC_SPI 20 IRQ_TYPE_EDGE_RISING>;
        };
    };
```
