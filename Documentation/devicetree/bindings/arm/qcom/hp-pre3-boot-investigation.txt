## Documentation/devicetree/bindings/spi/qcom,spi-qsd.yaml
```yaml
# SPDX-License-Identifier: GPL-2.0-only OR BSD-2-Clause
%YAML 1.2
---
$id: http://devicetree.org/schemas/spi/qcom,spi-qsd.yaml#
$schema: http://devicetree.org/meta-schemas/core.yaml#

title: Qualcomm QSD SPI Controller

maintainers:
  - webOS Community <webos-ports.org>

description: |
  The QSD SPI controller is the legacy SPI controller found on older
  Qualcomm SoCs such as the MSM7x30 family. It predates the QUP
  (Qualcomm Universal Peripheral) unified serial controller.

allOf:
  - $ref: spi-controller.yaml#

properties:
  compatible:
    const: qcom,spi-qsd

  reg:
    maxItems: 1

  interrupts:
    maxItems: 1

  clocks:
    minItems: 1
    maxItems: 2

  clock-names:
    minItems: 1
    items:
      - const: core
      - const: iface

  spi-max-frequency:
    maximum: 50000000

required:
  - compatible
  - reg
  - interrupts
  - clocks
  - clock-names

unevaluatedProperties: false

examples:
  - |
    #include <dt-bindings/clock/qcom,gcc-msm7x30.h>
    #include <dt-bindings/interrupt-controller/arm-gic.h>

    spi@a8000000 {
        compatible = "qcom,spi-qsd";
        reg = <0xa8000000 0x1000>;
        interrupts = <0>;
        clocks = <&gcc SPI_CLK>, <&gcc SPI_P_CLK>;
        clock-names = "core", "iface";
        spi-max-frequency = <26000000>;
        #address-cells = <1>;
        #size-cells = <0>;

        touchscreen@0 {
            compatible = "cypress,cy8ctma300";
            reg = <0>;
            spi-max-frequency = <1000000>;
        };
    };
```

## Documentation/devicetree/bindings/thermal/qcom,pm8901-temp-alarm.yaml
```yaml
# SPDX-License-Identifier: (GPL-2.0-only OR BSD-2-Clause)
%YAML 1.2
---
$id: http://devicetree.org/schemas/thermal/qcom,pm8901-temp-alarm.yaml#
$schema: http://devicetree.org/meta-schemas/core.yaml#

title: Qualcomm PM8901 PMIC Temperature Alarm

maintainers:
  - Herman van Hazendonk <github.com@herrie.org>

description: |
  PM8901 is a secondary PMIC paired with PM8058 on MSM8x60 family
  (MSM8260/MSM8660/APQ8060) platforms. It exposes an over-temperature
  alarm block at SSBI offset 0x23 (CTRL) with four selectable
  thresholds and three escalating stages.

  Unlike PM8058, there is no raw die-temperature ADC channel - the
  driver decodes the stage + threshold pair into a representative
  millicelsius value reported via the thermal-of framework.

  Two PMIC-internal interrupts are exposed:

    - TEMP_ALARM    (PM8901 IRQ block 6 bit 4 == hwirq 52): asserted
                    on every stage transition;
    - TEMP_HI_ALARM (PM8901 IRQ block 6 bit 5 == hwirq 53): asserted
                    when the part enters the high-temperature stage.

  Both line up on the parent qcom,pm8901 interrupt-controller.

allOf:
  - $ref: /schemas/thermal/thermal-sensor.yaml#

properties:
  compatible:
    const: qcom,pm8901-temp-alarm

  reg:
    description: SSBI offset of the temp-alarm CTRL register.
    maxItems: 1

  interrupts:
    items:
      - description: Stage-transition alarm interrupt (TEMP_ALARM).
      - description: Hi-temperature alarm interrupt (TEMP_HI_ALARM).

  interrupt-names:
    items:
      - const: alarm
      - const: hi-alarm

  "#thermal-sensor-cells":
    const: 0

required:
  - compatible
  - reg
  - interrupts
  - interrupt-names

additionalProperties: false

examples:
  - |
    #include <dt-bindings/interrupt-controller/irq.h>

    ssbi {
      #address-cells = <1>;
      #size-cells = <0>;

      pmic@0 {
        compatible = "qcom,pm8901";
        reg = <0>;
        #address-cells = <1>;
        #size-cells = <0>;
        #interrupt-cells = <2>;
        interrupt-controller;
        interrupt-parent = <&tlmm>;
        interrupts = <31 IRQ_TYPE_EDGE_RISING>;

        temp-alarm@23 {
          compatible = "qcom,pm8901-temp-alarm";
          reg = <0x23>;
          interrupts = <52 IRQ_TYPE_EDGE_RISING>,
                       <53 IRQ_TYPE_EDGE_RISING>;
          interrupt-names = "alarm", "hi-alarm";
          #thermal-sensor-cells = <0>;
        };
      };
    };
```

## Documentation/devicetree/bindings/usb/ci-hdrc-usb2.yaml
```yaml
# SPDX-License-Identifier: (GPL-2.0-only OR BSD-2-Clause)
%YAML 1.2
---
$id: http://devicetree.org/schemas/usb/ci-hdrc-usb2.yaml#
$schema: http://devicetree.org/meta-schemas/core.yaml#

title: USB2 ChipIdea USB controller

maintainers:
  - Xu Yang <xu.yang_2@nxp.com>
  - Peng Fan <peng.fan@nxp.com>

properties:
  compatible:
    oneOf:
      - enum:
          - chipidea,usb2
          - lsi,zevio-usb
          - nuvoton,npcm750-udc
          - nvidia,tegra20-ehci
          - nvidia,tegra20-udc
          - nvidia,tegra30-ehci
          - nvidia,tegra30-udc
          - nvidia,tegra114-udc
          - nvidia,tegra124-udc
          - nxp,s32g2-usb
          - qcom,ci-hdrc
      - items:
          - enum:
              - nvidia,tegra114-ehci
              - nvidia,tegra124-ehci
              - nvidia,tegra210-ehci
          - const: nvidia,tegra30-ehci
      - items:
          - const: xlnx,zynq-usb-2.20a
          - const: chipidea,usb2
      - items:
          - enum:
              - nuvoton,npcm845-udc
          - const: nuvoton,npcm750-udc
      - items:
          - enum:
              - nxp,s32g3-usb
          - const: nxp,s32g2-usb

  clocks:
    minItems: 1
    maxItems: 2

  clock-names:
    minItems: 1
    maxItems: 2

  operating-points-v2:
    description: A phandle to the OPP table containing the performance states.
    $ref: /schemas/types.yaml#/definitions/phandle

  phy-select:
    description:
      Phandler of TCSR node with two argument that indicate register
      offset, and phy index
    $ref: /schemas/types.yaml#/definitions/phandle-array
    items:
      - description: phandle to TCSR node
      - description: register offset
      - description: phy index

  nvidia,phy:
    description: phandle of usb phy that connects to the port. Use "phys" instead.
    $ref: /schemas/types.yaml#/definitions/phandle
    deprecated: true

  nvidia,needs-double-reset:
    description: Indicates double reset or not.
    type: boolean
    deprecated: true

  interconnects:
    maxItems: 2

  interconnect-names:
    maxItems: 2
    items:
      enum: [usb-mem, usb-dfab]

  wakeup-source: true

  qcom,charger-detect:
    type: boolean
    description:
      Enable optional BC 1.2 charger detection in the chipidea USB
      controller. When absent, the entire detection path is skipped.

  qcom,hp-charger-detect:
    type: boolean
    description:
      Extend BC 1.2 charger detection to recognise HP/Palm vendor
      charger variants. Implies qcom,charger-detect.

  qcom,phy-settle-seq:
    $ref: /schemas/types.yaml#/definitions/uint8-matrix
    description:
      Sequence of ULPI offset/value pairs written to the PHY after the
      controller-level link reset, to apply signal-quality (eye-diagram)
      tuning that earlier hardware revisions need before USB enumeration.
    items:
      items:
        - description: ULPI register offset
        - description: register value

  ulpi:
    type: object
    additionalProperties: false
    patternProperties:
      "^phy(-[0-9])?$":
        description: The phy child node for Qcom chips.
        type: object
        $ref: /schemas/phy/qcom,usb-hs-phy.yaml

required:
  - compatible

allOf:
  - $ref: chipidea,usb2-common.yaml#
  - $ref: usb-hcd.yaml#
  - $ref: usb-drd.yaml#

unevaluatedProperties: false

examples:
  - |
    #include <dt-bindings/interrupt-controller/arm-gic.h>
    #include <dt-bindings/clock/berlin2.h>

    usb@f7ed0000 {
        compatible = "chipidea,usb2";
        reg = <0xf7ed0000 0x10000>;
        interrupts = <GIC_SPI 11 IRQ_TYPE_LEVEL_HIGH>;
        clocks = <&chip CLKID_USB0>;
        phys = <&usb_phy0>;
        phy-names = "usb-phy";
        vbus-supply = <&reg_usb0_vbus>;
        itc-setting = <0x4>; /* 4 micro-frames */
         /* Incremental burst of unspecified length */
        ahb-burst-config = <0x0>;
        tx-burst-size-dword = <0x10>; /* 64 bytes */
        rx-burst-size-dword = <0x10>;
        extcon = <0>, <&usb_id>;
        phy-clkgate-delay-us = <400>;
        mux-controls = <&usb_switch>;
        mux-control-names = "usb_switch";
    };

...
```

## arch/arm/configs/mantaray_defconfig
```kconfig
# SPDX-License-Identifier: GPL-2.0
#
# HP Pre3 (mantaray) defconfig
# Qualcomm MSM7230 SoC - Single-core Scorpion ARMv7
#

# Basic kernel options
CONFIG_SYSVIPC=y
CONFIG_NO_HZ_IDLE=y
CONFIG_HIGH_RES_TIMERS=y
CONFIG_PREEMPT=y
CONFIG_IKCONFIG=y
CONFIG_IKCONFIG_PROC=y
CONFIG_LOG_BUF_SHIFT=18
CONFIG_CGROUPS=y
CONFIG_BLK_DEV_INITRD=y
CONFIG_EXPERT=y
CONFIG_KALLSYMS_ALL=y
CONFIG_EMBEDDED=y

# ARM architecture
CONFIG_ARCH_MULTI_V7=y
CONFIG_ARCH_MSM7X30=y
# CONFIG_ARCH_MULTI_V6 is not set
# CONFIG_ARCH_MULTI_V5 is not set

# CPU configuration
CONFIG_ARM_THUMB=y
CONFIG_SWP_EMULATE=y
CONFIG_HIGHMEM=y
CONFIG_ARM_APPENDED_DTB=y
CONFIG_ARM_ATAG_DTB_COMPAT=y
CONFIG_ARM_ATAG_DTB_COMPAT_CMDLINE_FROM_BOOTLOADER=y
CONFIG_ARM_BUILTIN_DTB=y
CONFIG_VFP=y
CONFIG_NEON=y

# No SMP on MSM7x30 (single-core Scorpion)
# CONFIG_SMP is not set

# Memory
CONFIG_CMA=y
CONFIG_CMA_SIZE_MBYTES=32
CONFIG_ZSMALLOC=y

# Kernel modules
CONFIG_MODULES=y
CONFIG_MODULE_UNLOAD=y
CONFIG_MODULE_FORCE_UNLOAD=y
CONFIG_MODVERSIONS=y

# Block layer
CONFIG_PARTITION_ADVANCED=y
CONFIG_MSDOS_PARTITION=y
CONFIG_EFI_PARTITION=y
# CONFIG_CORE_DUMP_DEFAULT_ELF_HEADERS is not set
# CONFIG_COMPAT_BRK is not set

# Networking
CONFIG_NET=y
CONFIG_PACKET=y
CONFIG_UNIX=y
CONFIG_INET=y
CONFIG_IP_PNP=y
CONFIG_IP_PNP_DHCP=y
# CONFIG_IPV6 is not set
CONFIG_NETFILTER=y
CONFIG_BT=m
CONFIG_BT_RFCOMM=m
CONFIG_BT_BNEP=m
CONFIG_BT_HIDP=m
CONFIG_BT_HCIUART=m
CONFIG_BT_HCIUART_H4=y
CONFIG_BT_HCIUART_BCM=y
CONFIG_CFG80211=m
CONFIG_MAC80211=m
CONFIG_RFKILL=y

# Device Drivers
CONFIG_DEVTMPFS=y
CONFIG_DEVTMPFS_MOUNT=y

# MTD for NAND/flash support
CONFIG_MTD=y
CONFIG_MTD_CMDLINE_PARTS=y
CONFIG_MTD_BLOCK=y

# Block devices
CONFIG_BLK_DEV_LOOP=y
CONFIG_BLK_DEV_RAM=y

# SCSI for USB mass storage
CONFIG_SCSI=y
CONFIG_BLK_DEV_SD=y
CONFIG_CHR_DEV_SG=y

# Network devices
CONFIG_NETDEVICES=y
CONFIG_USB_NET_DRIVERS=m
CONFIG_USB_USBNET=m
CONFIG_USB_NET_CDC_EEM=m
CONFIG_USB_NET_RNDIS_HOST=m
CONFIG_BRCMFMAC=m

# Input devices
CONFIG_INPUT_EVDEV=y
CONFIG_KEYBOARD_GPIO=y
CONFIG_KEYBOARD_PMIC8XXX=y
# CONFIG_KEYBOARD_ATKBD is not set
# CONFIG_MOUSE_PS2 is not set
CONFIG_INPUT_TOUCHSCREEN=y
CONFIG_TOUCHSCREEN_CY8CTMA300=y
CONFIG_INPUT_MISC=y
CONFIG_INPUT_PM8XXX_VIBRATOR=y
CONFIG_INPUT_PMIC8XXX_PWRKEY=y
CONFIG_INPUT_UINPUT=y

# Serial/TTY
# CONFIG_LEGACY_PTYS is not set
CONFIG_SERIAL_MSM=y
CONFIG_SERIAL_MSM_CONSOLE=y
CONFIG_SERIAL_DEV_BUS=y

# I2C
CONFIG_I2C=y
CONFIG_I2C_CHARDEV=y
CONFIG_I2C_QUP=y

# SPI
CONFIG_SPI=y
CONFIG_SPI_QUP=y
CONFIG_SPI_QCOM_QSD=y

# GPIO
CONFIG_GPIOLIB=y
CONFIG_GPIO_SYSFS=y

# Pinctrl - MSM7x30 specific
CONFIG_PINCTRL=y
CONFIG_PINCTRL_MSM=y
CONFIG_PINCTRL_MSM7X30=y
CONFIG_PINCTRL_QCOM_SSBI_PMIC=y

# Power/reset
CONFIG_POWER_RESET=y
CONFIG_POWER_SUPPLY=y

# MFD/PMIC
CONFIG_MFD_PM8XXX=y

# Regulators
CONFIG_REGULATOR=y
CONFIG_REGULATOR_FIXED_VOLTAGE=y
CONFIG_REGULATOR_GPIO=y

# Thermal
CONFIG_THERMAL=y

# Watchdog
CONFIG_WATCHDOG=y

# Clock drivers - MSM7x30 specific
CONFIG_COMMON_CLK=y
CONFIG_COMMON_CLK_QCOM=y
CONFIG_MSM_GCC_7X30=y

# USB
CONFIG_USB=y
CONFIG_USB_ANNOUNCE_NEW_DEVICES=y
CONFIG_USB_OTG=y
CONFIG_USB_EHCI_HCD=y
CONFIG_USB_EHCI_MSM=y
CONFIG_USB_ACM=m
CONFIG_USB_STORAGE=m
CONFIG_USB_CHIPIDEA=y
CONFIG_USB_CHIPIDEA_UDC=y
CONFIG_USB_CHIPIDEA_HOST=y
CONFIG_USB_MSM_OTG=y
CONFIG_USB_GADGET=y
CONFIG_USB_CONFIGFS=m
CONFIG_USB_CONFIGFS_SERIAL=y
CONFIG_USB_CONFIGFS_ACM=y
CONFIG_USB_CONFIGFS_NCM=y
CONFIG_USB_CONFIGFS_ECM=y
CONFIG_USB_CONFIGFS_F_FS=y
CONFIG_USB_ETH=m

# USB PHY
CONFIG_NOP_USB_XCEIV=y
CONFIG_USB_ULPI=y
CONFIG_USB_ULPI_BUS=y
CONFIG_PHY_QCOM_USB_HS=y

# MMC/SD/SDIO
CONFIG_MMC=y
CONFIG_MMC_BLOCK_MINORS=16
CONFIG_MMC_ARMMMCI=y

# LEDs
CONFIG_NEW_LEDS=y
CONFIG_LEDS_CLASS=y
CONFIG_LEDS_GPIO=y
CONFIG_LEDS_LM8502=y
CONFIG_LEDS_PM8058=y
CONFIG_LEDS_TRIGGERS=y
CONFIG_LEDS_TRIGGER_TIMER=y
CONFIG_LEDS_TRIGGER_HEARTBEAT=y
CONFIG_LEDS_TRIGGER_DEFAULT_ON=y

# RTC
CONFIG_RTC_CLASS=y
CONFIG_RTC_DRV_PM8XXX=y

# DMA
CONFIG_DMADEVICES=y
CONFIG_QCOM_BAM_DMA=y

# Display/Graphics (basic framebuffer for now)
CONFIG_FB=y
CONFIG_FB_SIMPLE=y
CONFIG_FRAMEBUFFER_CONSOLE=y
CONFIG_LOGO=y
CONFIG_BACKLIGHT_CLASS_DEVICE=y
CONFIG_BACKLIGHT_LM3528=y

# Sound (basic framework)
CONFIG_SOUND=y
CONFIG_SND=y
CONFIG_SND_DYNAMIC_MINORS=y
# CONFIG_SND_ARM is not set
# CONFIG_SND_SPI is not set
# CONFIG_SND_USB is not set
CONFIG_SND_SOC=y

# Qualcomm SoC drivers
CONFIG_QCOM_GSBI=y
CONFIG_QCOM_SMEM=y

# Device tree
CONFIG_USE_OF=y

# Filesystems
CONFIG_EXT2_FS=y
CONFIG_EXT3_FS=y
CONFIG_EXT4_FS=y
CONFIG_BTRFS_FS=m
CONFIG_FANOTIFY=y
CONFIG_FUSE_FS=m
CONFIG_OVERLAY_FS=m
CONFIG_MSDOS_FS=y
CONFIG_VFAT_FS=y
CONFIG_TMPFS=y
CONFIG_TMPFS_POSIX_ACL=y
CONFIG_SQUASHFS=y
CONFIG_SQUASHFS_XZ=y
CONFIG_NFS_FS=m
CONFIG_NLS_CODEPAGE_437=y
CONFIG_NLS_ISO8859_1=y
CONFIG_NLS_UTF8=y

# Crypto
CONFIG_CRYPTO_USER=m
CONFIG_CRYPTO_DEFLATE=y
CONFIG_CRYPTO_LZO=y

# Debug options
CONFIG_PRINTK_TIME=y
CONFIG_DYNAMIC_DEBUG=y
CONFIG_DEBUG_FS=y
CONFIG_MAGIC_SYSRQ=y
CONFIG_DEBUG_KERNEL=y
CONFIG_DEBUG_INFO_DWARF_TOOLCHAIN_DEFAULT=y
CONFIG_FRAME_POINTER=y
CONFIG_PANIC_TIMEOUT=5

# Early printk for debugging boot issues
CONFIG_DEBUG_LL=y
CONFIG_DEBUG_MSM7X30_UART=y
CONFIG_DEBUG_UART_PHYS=0xacc00000
CONFIG_DEBUG_UART_VIRT=0xfacc0000
CONFIG_EARLY_PRINTK=y
CONFIG_DEBUG_UNCOMPRESS=y

# Persistent storage for crash logs
CONFIG_PSTORE=y
CONFIG_PSTORE_CONSOLE=y
CONFIG_PSTORE_PMSG=y
CONFIG_PSTORE_RAM=y
# Ramoops will store last 64KB of kernel log
CONFIG_PSTORE_DEFAULT_KMSG_BYTES=65536

# USB Serial Gadget (for console during boot)
CONFIG_USB_G_SERIAL=m

# IIO Sensors
CONFIG_IIO=y
CONFIG_IIO_ST_SENSORS_I2C=y
CONFIG_IIO_ST_ACCEL_3AXIS=y
CONFIG_IIO_ST_ACCEL_I2C_3AXIS=y
CONFIG_IIO_ST_MAGN_3AXIS=y
CONFIG_IIO_ST_MAGN_I2C_3AXIS=y
```
